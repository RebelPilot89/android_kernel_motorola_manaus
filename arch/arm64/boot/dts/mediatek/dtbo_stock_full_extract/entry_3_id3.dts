/dts-v1/;
/plugin/;

/ {

	fragment@channel-id {
		target-path = "/";

		__overlay__ {
			channel-id-map = "acg", "amxbr", "amxpr", "amxmx", "amxcl", "amxar", "amxla", "amxpe", "amxco", "tefbr", "tefmx", "tefar", "tefcl", "tefpe", "tefco", "perar", "entcl", "iusmx", "niibr", "niicl", "niimx", "niipe", "oibr", "timbr", "tigco", "retbr", "retar", "retla", "retcl", "tefla", "retla1st", "tefunl", "tigca", "tigca1st", "retmx", "attmx", "womcl", "avaco", "retpe", "openla", "opencl", "openmx", "altmx", "openpe", "openpub", "undefined", "undefined", "undefined", "undefined", "undefined", "undefined", "undefined", "undefined", "undefined", "undefined", "undefined", "undefined", "undefined", "undefined", "undefined", "undefined", "undefined", "undefined", "undefined", "reteu", "retgb", "retfr", "retes", "retie", "retde", "vfgb", "vfde", "vffr", "o2gb", "o2de", "orafr", "bouyfr", "eegb", "tescogb", "yoigo", "oraes", "retapac", "retmea", "vfit", "vfes", "vfeu", "3gb", "tescoie", "altfr", "3ie", "altpt", "timit", "retma", "windit", "vfhu", "vfro", "telhu", "playpl", "oraeu", "dteu", "teleu", "pluspl", "dtpl", "tefes", "altice", "vipeu", "veoneu", "openeu", "reteu2", "demogb", "retdemo", "undefined", "undefined", "undefined", "undefined", "undefined", "undefined", "undefined", "undefined", "undefined", "undefined", "undefined", "undefined", "undefined", "undefined", "undefined", "undefined", "undefined", "retca", "bwaca", "tkpca", "vzw", "att", "tmo", "sprint", "repw", "attpre", "cricket", "cc", "usc", "tracfone", "retus", "metropcs", "rcica", "wndca", "dmc", "bby", "amz", "acg", "lra", "comcast", "fi", "vzwpre", "boost", "spectrum", "undefined", "undefined", "undefined", "undefined", "undefined", "undefined", "undefined", "undefined", "undefined", "undefined", "undefined", "undefined", "undefined", "undefined", "undefined", "undefined", "undefined", "undefined", "undefined", "undefined", "undefined", "undefined", "undefined", "undefined", "undefined", "undefined", "undefined", "undefined", "undefined", "undefined", "undefined", "undefined", "undefined", "undefined", "undefined", "undefined", "undefined", "retin", "retcn", "telstra", "vfau", "amzin", "jioin", "airin", "retid", "cmcc", "ctcn", "cucn", "retmm", "gt4gtw", "retth", "retru", "trueth", "smarthk", "mobilpk", "retsea", "retjp", "softbank", "optus", "retkr", "retjio", "ymobile", "lguplus", "docomo", "retanz", "cbncn", "kddi", "rakuten", "undefined", "undefined", "undefined", "undefined", "undefined", "undefined", "undefined", "undefined", "undefined", "undefined", "undefined", "undefined", "undefined", "undefined", "undefined", "undefined", "undefined", "undefined", "undefined", "undefined", "undefined", "undefined", "undefined", "undefined", "undefined", "undefined", "undefined", "undefined", "undefined", "undefined", "undefined", "undefined", "undefined";
		};
	};

	fragment@0 {
		target = <&utags>;

		__overlay__ {
			compatible = "mmi,utags";
			mmi,main-utags = "/dev/block/by-name/utags";
			mmi,backup-utags = "/dev/block/by-name/utagsBackup";
		};
	};

	fragment@1 {
		target = <&hw>;

		__overlay__ {
			compatible = "mmi,utags";
			mmi,dir-name = "hw";
			mmi,main-utags = "/dev/block/by-name/hw";
		};
	};

	fragment@2 {
		target = <&chosen>;

		__overlay__ {
			bootargs_ext = "console=tty0 root=/dev/ram \tloglevel=8 \tandroidboot.hardware=mt6879 \tinitcall_debug=1";
		};
	};

	fragment@3 {
		target = <&mtk_leds>;

		__overlay__ {
			compatible = "mediatek,i2c-leds";

			backlight {
				led_mode = <0x06>;
				gate_enable = <0x01>;
				pwm_config = <0x00 0x01 0x00 0x00 0x00>;
			};
		};
	};

	fragment@4 {
		target = <&odm>;

		__overlay__ {

			vibrator0: vibrator@0 {
				compatible = "mediatek,vibrator";
				vib_timer = <0x19>;
				vib_limit = <0x09>;
				vib_vol = <0x09>;
				status = "disabled";
				phandle = <0x7a>;
			};
		};
	};

	fragment@5 {
		target = <&pio>;

		__overlay__ {

			gps_pins_default: gps_default {
				phandle = <0x01>;
			};

			gps_l1_lna_pins_ol: gps_l1_lna@0 {
				phandle = <0x02>;

				pins_cmd_dat {
					pinmux = <0x1700>;
					output-low;
				};
			};

			gps_l1_lna_pins_dsp_ctrl: gps_l1_lna@1 {
				phandle = <0x03>;

				pins_cmd_dat {
					pinmux = <0x1701>;
				};
			};

			gps_l1_lna_pins_oh: gps_l1_lna@2 {
				phandle = <0x04>;

				pins_cmd_dat {
					pinmux = <0x1700>;
					output-high;
				};
			};

			gps_l5_lna_pins_ol: gps_l5_lna@0 {
				phandle = <0x05>;

				pins_cmd_dat {
					pinmux = <0x1a00>;
					output-low;
				};
			};

			gps_l5_lna_pins_dsp_ctrl: gps_l5_lna@1 {
				phandle = <0x06>;

				pins_cmd_dat {
					pinmux = <0x1a04>;
				};
			};

			gps_l5_lna_pins_oh: gps_l5_lna@2 {
				phandle = <0x07>;

				pins_cmd_dat {
					pinmux = <0x1a00>;
					output-high;
				};
			};
		};
	};

	fragment@6 {
		target = <&gps>;

		__overlay__ {
			pinctrl-names = "default", "gps_l1_lna_disable", "gps_l1_lna_dsp_ctrl", "gps_l1_lna_enable", "gps_l5_lna_disable", "gps_l5_lna_dsp_ctrl", "gps_l5_lna_enable";
			pinctrl-0 = <&gps_pins_default>;
			pinctrl-1 = <&gps_l1_lna_pins_ol>;
			pinctrl-2 = <&gps_l1_lna_pins_dsp_ctrl>;
			pinctrl-3 = <&gps_l1_lna_pins_oh>;
			pinctrl-4 = <&gps_l5_lna_pins_ol>;
			pinctrl-5 = <&gps_l5_lna_pins_dsp_ctrl>;
			pinctrl-6 = <&gps_l5_lna_pins_oh>;
			status = "okay";
		};
	};

	fragment@7 {
		target = <&pio>;

		__overlay__ {

			sel_up: sel_high {
				phandle = <0x0a>;

				pins_cmd_dat {
					pinmux = <0x3c00>;
					output-high;
				};
			};

			sel_down: sel_low {
				phandle = <0x0b>;

				pins_cmd_dat {
					pinmux = <0x3c00>;
					output-low;
				};
			};

			sw_enable: sw_enable {
				phandle = <0x0c>;

				pins_cmd_dat {
					pinmux = <0x3b00>;
					output-low;
				};
			};

			sw_disable: sw_disable {
				phandle = <0x0d>;

				pins_cmd_dat {
					pinmux = <0x3b00>;
					output-low;
				};
			};

			ps_enable: ps_enable {
				phandle = <0x08>;

				pins_cmd_dat {
					pinmux = <0x8800>;
					output-high;
				};
			};

			ps_disable: ps_disable {
				phandle = <0x09>;

				pins_cmd_dat {
					pinmux = <0x8800>;
					output-low;
				};
			};
		};
	};

	fragment@8 {
		target = <&ps5169>;

		__overlay__ {
			pinctrl-names = "enable", "disable";
			pinctrl-0 = <&ps_enable>;
			pinctrl-1 = <&ps_disable>;
			status = "okay";
		};
	};

	fragment@9 {
		target = <&fusb304>;

		__overlay__ {
			pinctrl-names = "sel_up", "sel_down", "enable", "disable";
			pinctrl-0 = <&sel_up>;
			pinctrl-1 = <&sel_down>;
			pinctrl-2 = <&sw_enable>;
			pinctrl-3 = <&sw_disable>;
			status = "okay";
		};
	};

	fragment@10 {
		target = <&mt6375_typec>;

		__overlay__ {

			port {

				tcpc_typec_usb: endpoint@0 {
					remote-endpoint = <&ssusb_mux>;
					phandle = <0x0f>;
				};
			};
		};
	};

	fragment@11 {
		target = <&typec_mux_switch>;

		__overlay__ {
			orientation-switch;
			mode-switch;
			accessory;

			port {

				ssusb_mux: endpoint@0 {
					remote-endpoint = <&tcpc_typec_usb>;
					phandle = <0x0e>;
				};
			};
		};
	};

	fragment@12 {
		target = <&pio>;

		__overlay__ {

			mtkfb_pins_lcm_led_en1: lcm_led_en1_gpio {
				phandle = <0x10>;

				pins_cmd_dat {
					pinmux = <0xa300>;
					slew-rate = <0x01>;
					output-high;
				};
			};

			mtkfb_pins_lcm_led_en0: lcm_led_en0_gpio {
				phandle = <0x11>;

				pins_cmd_dat {
					pinmux = <0xa300>;
					slew-rate = <0x01>;
					output-low;
				};
			};

			mtkfb_pins_lcm_rst_out1_gpio: lcm_rst_out1_gpio {
				phandle = <0x12>;

				pins_cmd_dat {
					pinmux = <0x6100>;
					slew-rate = <0x01>;
					output-high;
				};
			};

			mtkfb_pins_lcm_rst_out0_gpio: lcm_rst_out0_gpio {
				phandle = <0x13>;

				pins_cmd_dat {
					pinmux = <0x6100>;
					slew-rate = <0x01>;
					output-low;
				};
			};

			mtkfb_pins_lcm_dsi_te: lcm_dsi_te {
				phandle = <0x14>;

				pins_cmd_dat {
					pinmux = <0x6001>;
				};
			};
		};
	};

	fragment@13 {
		target = <&mtkfb>;

		__overlay__ {
			pinctrl-names = "lcm_led_en1_gpio", "lcm_led_en0_gpio", "lcm_rst_out1_gpio", "lcm_rst_out0_gpio", "mode_te_te";
			pinctrl-0 = <&mtkfb_pins_lcm_led_en1>;
			pinctrl-1 = <&mtkfb_pins_lcm_led_en0>;
			pinctrl-2 = <&mtkfb_pins_lcm_rst_out1_gpio>;
			pinctrl-3 = <&mtkfb_pins_lcm_rst_out0_gpio>;
			pinctrl-4 = <&mtkfb_pins_lcm_dsi_te>;
			status = "okay";
		};
	};

	fragment@14 {
		target = <&dispsys_config>;

		__overlay__ {
			pinctrl-names = "lcm_rst_out1_gpio", "lcm_rst_out0_gpio", "mode_te_te";
			pinctrl-0 = <&mtkfb_pins_lcm_rst_out1_gpio>;
			pinctrl-1 = <&mtkfb_pins_lcm_rst_out0_gpio>;
			pinctrl-2 = <&mtkfb_pins_lcm_dsi_te>;
			status = "okay";
		};
	};

	fragment@15 {
		target = <&dsi0>;

		__overlay__ {
			status = "okay";
			#address-cells = <0x01>;
			#size-cells = <0x00>;

			panel1: panel1@0 {
				compatible = "jdi,nt36672e,vdo,120hz,hfp";
				reg = <0x00>;
				pm-enable-gpios = <&pio>, <0xa3 0x00>;
				reset-gpios = <&pio>, <0x61 0x00>;
				gate-ic = <0x12df>;
				pinctrl-names = "default";
				phandle = <0x7b>;
			};

			ports {

				port {

					dsi_out: endpoint {
						remote-endpoint = <&panel_in1>;
						phandle = <0x3d>;
					};
				};
			};
		};
	};

	fragment@16 {
		target = <&connfem>;

		__overlay__ {

			epa_elna_mtk {
				parts = <&nofem>, <&nofem>, <&qm42195>, <&qm45197>, <&nofem>, <&wlan3002c_laa>, <&qm42195>, <&qm45197_laa>, <&qm42195>, <&qm45197>, <&qm42195>, <&qm45197>, <&qm42195>, <&qm45197>, <&wlan7207h>, <&wlan7205c>, <&wlan7207h>, <&wlan7205c>;

				hwid {
					gpio = <&pio>, <0x7d 0x00>;

					pmic {
						channel_name = "pmic_vin1";
						range-0 = <0x140>;
					};
				};

				wifi {

					flags-2 {
						laa;
					};

					flags-3 {
						laa;
					};

					flags-4 {
						open-loop;
					};

					flags-6 {
						open-loop;
					};

					flags-8 {
						open-loop;
					};
				};

				bt {

					flags-1 {
						epa_elna;
					};

					flags-3 {
						epa_elna;
					};

					flags-4 {
						epa_elna;
					};

					flags-5 {
						bypass;
					};

					flags-6 {
						bypass;
					};

					flags-7 {
						epa_elna;
					};

					flags-8 {
						epa_elna;
					};
				};
			};
		};
	};

	fragment@17 {
		target = <&i2c6>;

		__overlay__ {

			spk: speaker_amp@5c {
				compatible = "richtek,rt5512";
				#sound-dai-cells = <0x00>;
				reg = <0x5c>;
				status = "disabled";
				sound-name-prefix = "Left";
				phandle = <0x16>;
			};
		};
	};

	fragment@18 {
		target = <&sound>;

		__overlay__ {
			mediatek,spk-i2s = <0x01 0x02>;

			mediatek,speaker-codec {
				sound-dai = <&spk>;
			};
		};
	};

	fragment@19 {
		target = <&afe>;

		__overlay__ {
			pinctrl-names = "aud_clk_mosi_off", "aud_clk_mosi_on", "aud_dat_mosi_off", "aud_dat_mosi_on", "aud_dat_mosi_ch34_off", "aud_dat_mosi_ch34_on", "aud_dat_miso0_off", "aud_dat_miso0_on", "aud_dat_miso1_off", "aud_dat_miso1_on", "aud_dat_miso2_off", "aud_dat_miso2_on", "vow_dat_miso_off", "vow_dat_miso_on", "vow_clk_miso_off", "vow_clk_miso_on", "aud_gpio_i2s2_off", "aud_gpio_i2s2_on", "aud_gpio_i2s1_off", "aud_gpio_i2s1_on";
			pinctrl-0 = <&aud_clk_mosi_off>;
			pinctrl-1 = <&aud_clk_mosi_on>;
			pinctrl-2 = <&aud_dat_mosi_off>;
			pinctrl-3 = <&aud_dat_mosi_on>;
			pinctrl-4 = <&aud_dat_mosi_ch34_off>;
			pinctrl-5 = <&aud_dat_mosi_ch34_on>;
			pinctrl-6 = <&aud_dat_miso0_off>;
			pinctrl-7 = <&aud_dat_miso0_on>;
			pinctrl-8 = <&aud_dat_miso1_off>;
			pinctrl-9 = <&aud_dat_miso1_on>;
			pinctrl-10 = <&aud_dat_miso2_off>;
			pinctrl-11 = <&aud_dat_miso2_on>;
			pinctrl-12 = <&vow_dat_miso_off>;
			pinctrl-13 = <&vow_dat_miso_on>;
			pinctrl-14 = <&vow_clk_miso_off>;
			pinctrl-15 = <&vow_clk_miso_on>;
			pinctrl-16 = <&aud_gpio_i2s2_off>;
			pinctrl-17 = <&aud_gpio_i2s2_on>;
			pinctrl-18 = <&aud_gpio_i2s1_off>;
			pinctrl-19 = <&aud_gpio_i2s1_on>;
		};
	};

	fragment@20 {
		target = <&pio>;

		__overlay__ {

			aud_clk_mosi_off: aud_clk_mosi_off {
				phandle = <0x17>;

				pins_cmd0_dat {
					pinmux = <0xb200>;
					input-enable;
					bias-pull-down;
				};
			};

			aud_clk_mosi_on: aud_clk_mosi_on {
				phandle = <0x18>;

				pins_cmd0_dat {
					pinmux = <0xb201>;
					input-schmitt-enable;
					bias-disable;
				};
			};

			aud_dat_mosi_off: aud_dat_mosi_off {
				phandle = <0x19>;

				pins_cmd1_dat {
					pinmux = <0xb400>;
					input-enable;
					bias-pull-down;
				};
			};

			aud_dat_mosi_on: aud_dat_mosi_on {
				phandle = <0x1a>;

				pins_cmd1_dat {
					pinmux = <0xb401>;
					input-schmitt-enable;
					bias-disable;
				};
			};

			aud_dat_mosi_ch34_off: aud_dat_mosi_ch34_off {
				phandle = <0x1b>;

				pins_cmd1_dat {
					pinmux = <0xb500>;
					input-enable;
					bias-pull-down;
				};
			};

			aud_dat_mosi_ch34_on: aud_dat_mosi_ch34_on {
				phandle = <0x1c>;

				pins_cmd1_dat {
					pinmux = <0xb501>;
					input-schmitt-enable;
					bias-disable;
				};
			};

			aud_dat_miso0_off: aud_dat_miso0_off {
				phandle = <0x1d>;

				pins_cmd1_dat {
					pinmux = <0xb900>;
					input-enable;
					bias-pull-down;
				};
			};

			aud_dat_miso0_on: aud_dat_miso0_on {
				phandle = <0x1e>;

				pins_cmd1_dat {
					pinmux = <0xb901>;
					input-schmitt-enable;
					bias-disable;
				};
			};

			aud_dat_miso1_off: aud_dat_miso1_off {
				phandle = <0x1f>;

				pins_cmd2_dat {
					pinmux = <0xba00>;
					input-enable;
					bias-disable;
				};
			};

			aud_dat_miso1_on: aud_dat_miso1_on {
				phandle = <0x20>;

				pins_cmd2_dat {
					pinmux = <0xba01>;
					input-schmitt-enable;
					bias-disable;
				};
			};

			aud_dat_miso2_off: aud_dat_miso2_off {
				phandle = <0x21>;

				pins_cmd1_dat {
					pinmux = <0xbb00>;
					input-enable;
					bias-pull-down;
				};
			};

			aud_dat_miso2_on: aud_dat_miso2_on {
				phandle = <0x22>;

				pins_cmd1_dat {
					pinmux = <0xbb01>;
					input-schmitt-enable;
					bias-disable;
				};
			};

			vow_dat_miso_off: vow_dat_miso_off {
				phandle = <0x23>;

				pins_cmd1_dat {
					pinmux = <0xb900>;
					input-enable;
					bias-pull-down;
				};
			};

			vow_dat_miso_on: vow_dat_miso_on {
				phandle = <0x24>;

				pins_cmd1_dat {
					pinmux = <0xb902>;
					input-schmitt-enable;
					bias-disable;
				};
			};

			vow_clk_miso_off: vow_clk_miso_off {
				phandle = <0x25>;

				pins_cmd3_dat {
					pinmux = <0xba00>;
					input-enable;
					bias-pull-down;
				};
			};

			vow_clk_miso_on: vow_clk_miso_on {
				phandle = <0x26>;

				pins_cmd1_dat {
					pinmux = <0xba02>;
					input-schmitt-enable;
					bias-disable;
				};
			};

			aud_nle_mosi_off: aud_nle_mosi_off {
				phandle = <0x7c>;

				pins_cmd1_dat {
					pinmux = <0xb700>;
					input-enable;
					bias-pull-down;
				};

				pins_cmd2_dat {
					pinmux = <0xb800>;
					input-enable;
					bias-pull-down;
				};
			};

			aud_nle_mosi_on: aud_nle_mosi_on {
				phandle = <0x7d>;

				pins_cmd1_dat {
					pinmux = <0xb701>;
					input-schmitt-enable;
					bias-disable;
				};

				pins_cmd2_dat {
					pinmux = <0xb801>;
					input-schmitt-enable;
					bias-disable;
				};
			};

			aud_gpio_i2s2_off: aud_gpio_i2s2_off {
				phandle = <0x27>;

				pins_cmd1_dat {
					pinmux = <0x2700>;
					input-enable;
					bias-pull-down;
				};
			};

			aud_gpio_i2s2_on: aud_gpio_i2s2_on {
				phandle = <0x28>;

				pins_cmd1_dat {
					pinmux = <0x2703>;
					input-schmitt-enable;
					bias-disable;
				};
			};

			aud_gpio_i2s1_off: aud_gpio_i2s1_off {
				phandle = <0x29>;

				pins_cmd1_dat {
					pinmux = <0x2400>;
					input-enable;
					bias-pull-down;
				};

				pins_cmd2_dat {
					pinmux = <0x2500>;
					input-enable;
					bias-pull-down;
				};

				pins_cmd3_dat {
					pinmux = <0x2600>;
					input-enable;
					bias-pull-down;
				};
			};

			aud_gpio_i2s1_on: aud_gpio_i2s1_on {
				phandle = <0x2a>;

				pins_cmd1_dat {
					pinmux = <0x2401>;
					input-schmitt-enable;
					bias-disable;
				};

				pins_cmd2_dat {
					pinmux = <0x2501>;
					input-schmitt-enable;
					bias-disable;
				};

				pins_cmd3_dat {
					pinmux = <0x2601>;
					input-schmitt-enable;
					bias-disable;
				};
			};

			sar_int_default: sar_int_default {
				phandle = <0x2b>;

				pins_cmd_dat {
					pinmux = <0x7700>;
					input-enable;
					drive-strength = <0x02>;
					bias-pull-up;
				};
			};

			sar_int_sleep: sar_int_sleep {
				phandle = <0x2c>;

				pins_cmd_dat {
					pinmux = <0x7700>;
					input-enable;
					drive-strength = <0x02>;
					bias-pull-up;
				};
			};
		};
	};

	fragment@21 {
		target = <&mt6363_vio18>;

		__overlay__ {
			regulator-min-microvolt = <0x1b7740>;
			regulator-max-microvolt = <0x200b20>;
		};
	};

	fragment@22 {
		target = <&i2c7>;

		__overlay__ {
			status = "okay";

			sx937x: sx937x@2c {
				compatible = "Semtech,sx937x";
				reg = <0x2c>;
				pinctrl-names = "default", "sleep";
				pinctrl-0 = <&sar_int_default>;
				pinctrl-1 = <&sar_int_sleep>;
				interrupt-parent = <&pio>;
				interrupts = <0x77 0x02>;
				interrupt-names = "sx937x_irq";
				Semtech,nirq-gpio = <&pio>, <0x77 0x02>;
				cap_vdd-supply = <&mt6363_vio18>;
				Semtech,ref-phases-a = <0x05>;
				Semtech,ref-phases-b = <0x06>;
				Semtech,ref-phases-c = <0xff>;
				Semtech,button-flag = <0x07>;
				Semtech,reg-num = <0x3a>;
				Semtech,reg-init = <0x8024 0x7f00 0x4004 0x70 0x4008 0x08 0x8020 0x32 0x8028 0x866 0x8034 0x85e 0x8040 0x87e 0x804c 0x68e 0x8058 0x85e 0x8064 0x85e 0x8070 0x85e 0x807c 0x85e 0x8030 0x924925 0x803c 0x925924 0x8048 0x964924 0x8054 0x924924 0x8060 0xb24924 0x806c 0x92492c 0x8078 0x924964 0x8084 0xbff9ff 0x8098 0x5240 0x80b8 0x4a2f 0x80d8 0x4a4a 0x80f8 0x6464 0x8118 0x6464 0x8138 0x5a40 0x8158 0x5a40 0x8178 0x5a40 0x80a0 0x22220001 0x80c0 0x32320002 0x80e0 0x6a6a0002 0x8188 0x8000005 0x818c 0x8000006 0x8190 0x8000004 0x8090 0x28e95000 0x80b0 0x78c45000 0x80d0 0x78903010 0x80f0 0x54ac5000 0x8110 0x54ac5000 0x8130 0x54ac5000 0x8150 0x54ac5000 0x8170 0x54ac5000 0x8088 0x300000 0x80a8 0x300000 0x80c8 0x300000 0x80e8 0x300000 0x8108 0x300000 0x8128 0x300000 0x8148 0x300000 0x8168 0x300000 0x808c 0x60200030 0x80ac 0x60200030 0x80cc 0x60200030 0x80ec 0x60200030 0x810c 0x60200030 0x812c 0x60200030 0x814c 0x60200030 0x816c 0x60200030>;
				status = "okay";
				phandle = <0x7e>;
			};

			awinic_sar: awinic_sar@12 {
				compatible = "awinic,aw_sar";
				reg = <0x12>;
				sar-num = <0x00>;
				pinctrl-names = "default", "sleep";
				pinctrl-0 = <&sar_int_default>;
				pinctrl-1 = <&sar_int_sleep>;
				interrupt-parent = <&pio>;
				interrupts = <0x77 0x02>;
				interrupt-names = "awinic_irq";
				irq-gpio = <&pio>, <0x77 0x02>;
				channel_use_flag = <0x07>;
				aw_sar,use_plug_cail;
				aw_sar,update_fw;
				aw_sar,using_pm_ops;
				start-mode = <0x01>;
				irq-mux = <0x02>;
				status = "okay";
				phandle = <0x7f>;
			};
		};
	};

	fragment@23 {
		target = <&consys>;

		__overlay__ {
			tcxo_support = "false";
			pinctrl-names = "default", "conninfra_tcxo_set", "conninfra_tcxo_clr";
			pinctrl-0 = <&conninfra_pins_default>;
			pinctrl-1 = <&conninfra_pins_tcxo_set>;
			pinctrl-2 = <&conninfra_pins_tcxo_clr>;
			status = "okay";
		};
	};

	fragment@24 {
		target = <&pio>;

		__overlay__ {

			conninfra_pins_default: conninfra_pins_default {
				phandle = <0x2d>;
			};

			conninfra_pins_tcxo_set: conninfra_tcxo_set@gpio {
				phandle = <0x2e>;

				pins_cmd_dat {
					pinmux = <0xa801>;
				};
			};

			conninfra_pins_tcxo_clr: conninfra_tcxo_clr@gpio {
				phandle = <0x2f>;

				pins_cmd_dat {
					pinmux = <0xa800>;
				};
			};
		};
	};

	fragment@25 {
		target = <&fusb304>;

		__overlay__ {
			status = "disabled";
		};
	};

	fragment@26 {
		target = <&spi3>;

		__overlay__ {
			status = "okay";
			#address-cells = <0x01>;
			#size-cells = <0x00>;
			mediatek,pad-select = <0x00 0x01>;
			pinctrl-names = "default", "gt9896s_int_active", "gt9896s_reset_active", "gt9896s_int_suspend", "gt9896s_reset_suspend", "gt9896s_spi_mode";
			pinctrl-0 = <&ctp_gt9896s_pins_default>;
			pinctrl-1 = <&ctp_gt9896s_int_active>;
			pinctrl-2 = <&ctp_gt9896s_reset_active>;
			pinctrl-3 = <&ctp_gt9896s_int_suspend>;
			pinctrl-4 = <&ctp_gt9896s_reset_suspend>;
			pinctrl-5 = <&ctp_gt9896s_spi_mode>;

			goodix_ts_spi@0 {
				status = "ok";
				compatible = "goodix,gt9916S";
				reg = <0x00>;
				pinctrl-names = "pmx_ts_active", "pmx_ts_suspend", "stylus_clk_active", "stylus_clk_suspend";
				pinctrl-0 = <&ctp_gt9896s_int_active>, <&ctp_gt9896s_reset_active>;
				pinctrl-1 = <&ctp_gt9896s_int_suspend>, <&ctp_gt9896s_reset_suspend>;
				pinctrl-2 = <&ctp_gt9896s_stylus_active>;
				pinctrl-3 = <&ctp_gt9896s_stylus_suspend>;
				mmi,status = "/chosen", "mmi,panel_name", "contains", "tm_vtdr6115", "boe_cmd_nt37701A";
				spi-max-frequency = <0x927c00>;
				goodix,reset-gpio = <&pio>, <0x9f 0x00>;
				goodix,irq-gpio = <&pio>, <0x16 0x2002>;
				goodix,avdd-gpio = <&pio>, <0xa7 0x00>;
				goodix,iovdd-name = "vtouch";
				vtouch-supply = <&mt6368_vtp>;
				goodix,irq-flags = <0x2002>;
				goodix,panel-max-id = <0x0a>;
				goodix,panel-max-x = <0x4380>;
				goodix,panel-max-y = <0x9600>;
				goodix,panel-max-w = <0x100>;
				goodix,panel-max-p = <0x100>;
				goodix,edge-ctrl;
				goodix,sample-ctrl;
				goodix,interpolation-ctrl;
				goodix,stowed-mode-ctrl;
				mmi,enable-gestures;
				mmi,power-off-suspend;
				mmi,usb-charger-detection;
				mmi,supported_gesture_type = <0x07>;
				mtk-charger = <&mt6375_chg>;
			};

			focaltech@1 {
				status = "ok";
				compatible = "focaltech,fts";
				reg = <0x01>;
				spi-max-frequency = <0xb71b00>;
				focaltech,reset-gpio = <&pio>, <0x9f 0x00>;
				focaltech,irq-gpio = <&pio>, <0x16 0x2800>;
				focaltech,max-touch-number = <0x0a>;
				focaltech,display-coords = <0x00 0x00 0x4380 0x9600>;
				focaltech,panel-supplier = "csot";
				vcc_i2c-supply = <&mt6368_vtp>;
				focaltech,vdd-gpio = <&pio>, <0xa7 0x00>;
				pinctrl-names = "pmx_ts_active", "pmx_ts_suspend", "pmx_ts_release";
				pinctrl-0 = <&ctp_gt9896s_int_active>, <&ctp_gt9896s_reset_active>;
				pinctrl-1 = <&ctp_gt9896s_int_suspend>, <&ctp_gt9896s_reset_suspend>;
				pinctrl-2 = <&ctp_gpio_release>;
				mmi,status = "/chosen", "mmi,panel_name", "contains", "csot_vtdr6115";
				focaltech,edge-ctrl;
				focaltech,sample-ctrl;
				focaltech,interpolation-ctrl;
				focaltech,stowed-mode-ctrl;
				mmi,enable-gestures;
				mmi,supported_gesture_type = <0x07>;
				mmi,usb-charger-detection;
				mtk-charger = <&mt6375_chg>;
			};
		};
	};

	fragment@27 {
		target = <&pio>;

		__overlay__ {

			ctp_gt9896s_pins_default: pins_default {
				phandle = <0x30>;
			};

			ctp_gt9896s_int_active: int1_active {
				phandle = <0x31>;

				pins_cmd_dat {
					pinmux = <0x1600>;
					input-enable;
				};
			};

			ctp_gt9896s_reset_active: reset1_active {
				phandle = <0x32>;

				pins_cmd_dat {
					pinmux = <0x9f00>;
					output-high;
				};
			};

			ctp_gt9896s_stylus_active: stylus1_active {
				phandle = <0x36>;

				pins_cmd_dat {
					pinmux = <0x3b00>;
					output-high;
				};
			};

			ctp_gt9896s_int_suspend: int1_suspend {
				phandle = <0x33>;

				pins_cmd_dat {
					pinmux = <0x1600>;
					output-low;
				};
			};

			ctp_gt9896s_reset_suspend: reset1_suspend {
				phandle = <0x34>;

				pins_cmd_dat {
					pinmux = <0x9f00>;
					output-low;
				};
			};

			ctp_gt9896s_stylus_suspend: stylus1_suspend {
				phandle = <0x37>;

				pins_cmd_dat {
					pinmux = <0x3b00>;
					output-low;
				};
			};

			ctp_gt9896s_spi_mode: spimode_default {
				phandle = <0x35>;

				pins_cmd_dat {
					pinmux = <0x4b02 0x4c02 0x4d02 0x4e02>;
					drive-strength = <0x02>;
				};
			};

			ctp_gpio_release: gpio_release {
				phandle = <0x38>;

				pins_cmd_dat {
					pinmux = <0x1600 0x9f00>;
					drive-strength = <0x02>;
					bias-disable;
				};
			};
		};
	};

	fragment@28 {
		target = <&dispsys_config>;

		__overlay__ {
			force_dyn_mipi_change;
		};
	};

	fragment@29 {
		target = <&mtk_leds>;

		__overlay__ {
			compatible = "mediatek,disp-leds";

			backlight {
				label = "lcd-backlight";
				led_mode = <0x04>;
				max-brightness = <0xfff>;
				max-hw-brightness = <0xfff>;
				default-brightness = <0xa11>;
			};
		};
	};

	fragment@30 {
		target = <&mtkfb>;

		__overlay__ {
			pinctrl-names = "lcm_rst_out0_gpio", "mode_te_te", "oled_vci_en_gpio", "oled_vio_en_gpio", "oled_dvdd_en0_gpio", "oled_dvdd_en1_gpio";
			pinctrl-0 = <&mtkfb_pins_lcm_rst_out0_gpio>;
			pinctrl-1 = <&mtkfb_pins_lcm_dsi_te>;
			pinctrl-2 = <&mtkfb_pins_oled_vci_en>;
			pinctrl-3 = <&mtkfb_pins_oled_vio_en>;
			pinctrl-4 = <&mtkfb_pins_oled_avdd_en0>;
			pinctrl-5 = <&mtkfb_pins_oled_avdd_en1>;
			status = "okay";
		};
	};

	fragment@31 {
		target = <&pio>;

		__overlay__ {

			mtkfb_pins_oled_vci_en: oled_vci_en_gpio {
				phandle = <0x39>;

				pins_cmd_dat {
					pinmux = <0xa600>;
					slew-rate = <0x01>;
					output-low;
				};
			};

			mtkfb_pins_oled_vio_en: oled_vio_en_gpio {
				phandle = <0x3a>;

				pins_cmd_dat {
					pinmux = <0xa400>;
					slew-rate = <0x01>;
					output-low;
				};
			};

			mtkfb_pins_oled_avdd_en0: oled_dvdd_en0_gpio {
				phandle = <0x3b>;

				pins_cmd_dat {
					pinmux = <0x6700>;
					slew-rate = <0x01>;
					output-low;
				};
			};

			mtkfb_pins_oled_avdd_en1: oled_dvdd_en1_gpio {
				phandle = <0x3c>;

				pins_cmd_dat {
					pinmux = <0xa500>;
					slew-rate = <0x01>;
					output-low;
				};
			};
		};
	};

	fragment@32 {
		target = <&dsi0>;

		__overlay__ {
			status = "okay";

			panel1@0 {
				compatible = "tianma,vtdr6115,vdo,144hz";
				reg = <0x00>;
				pm-enable-gpios = <&pio>, <0xa4 0x00>, <&pio>, <0xa6 0x00>, <&pio>, <0x67 0x00>, <&pio>, <0xa5 0x00>;
				reset-gpios = <&pio>, <0x61 0x00>;
				pinctrl-names = "default";
				lhbm-enable;

				port {

					panel_in1: endpoint {
						remote-endpoint = <&dsi_out>;
						phandle = <0x15>;
					};
				};
			};

			panel2@0 {
				compatible = "csot,vtdr6115,vdo,144hz,c7";
				reg = <0x01>;
				pm-enable-gpios = <&pio>, <0xa4 0x00>, <&pio>, <0xa6 0x00>, <&pio>, <0x67 0x00>, <&pio>, <0xa5 0x00>;
				reset-gpios = <&pio>, <0x61 0x00>;
				pinctrl-names = "default";
				lhbm-enable;

				port {

					panel_in2: endpoint {
						remote-endpoint = <&dsi_out>;
						phandle = <0x80>;
					};
				};
			};

			panel3@0 {
				compatible = "tianma,vtdr6115,vdo,144hz,u8";
				reg = <0x02>;
				pm-enable-gpios = <&pio>, <0xa4 0x00>, <&pio>, <0xa6 0x00>, <&pio>, <0x67 0x00>, <&pio>, <0xa5 0x00>;
				reset-gpios = <&pio>, <0x61 0x00>;
				pinctrl-names = "default";
				lhbm-enable;

				port {

					panel_in3: endpoint {
						remote-endpoint = <&dsi_out>;
						phandle = <0x81>;
					};
				};
			};

			panel4@0 {
				compatible = "boe,nt37701a,cmd,144hz";
				reg = <0x03>;
				pm-enable-gpios = <&pio>, <0xa4 0x00>, <&pio>, <0xa5 0x00>, <&pio>, <0xa6 0x00>;
				reset-gpios = <&pio>, <0x61 0x00>;
				pinctrl-names = "default";
				lhbm-enable;

				port {

					panel_in4: endpoint {
						remote-endpoint = <&dsi_out>;
						phandle = <0x82>;
					};
				};
			};
		};
	};

	fragment@33 {
		target = <&mt6368_vio28>;

		__overlay__ {
			regulator-name = "mt6368_vio28";
			regulator-min-microvolt = <0x325aa0>;
			regulator-max-microvolt = <0x325aa0>;
			regulator-enable-ramp-delay = <0x780>;
		};
	};

	fragment@34 {
		target = <&pio>;

		__overlay__ {

			pen_int_default: pen_int_default {
				phandle = <0x3e>;

				pins_cmd_dat {
					pinmux = <0x3f00 0x4000>;
					drive-strength = <0x02>;
					input-enable;
				};
			};

			pen_int_sleep: pen_int_sleep {
				phandle = <0x3f>;

				pins_cmd_dat {
					pinmux = <0x3f00 0x4000>;
					drive-strength = <0x02>;
					input-enable;
				};
			};

			folio_int_default: folio_int_default {
				phandle = <0x40>;

				pins_cmd_dat {
					pinmux = <0x2000 0x2100>;
					drive-strength = <0x02>;
					input-enable;
				};
			};

			folio_int_sleep: folio_int_sleep {
				phandle = <0x41>;

				pins_cmd_dat {
					pinmux = <0x2000 0x2100>;
					drive-strength = <0x02>;
					input-enable;
				};
			};
		};
	};

	fragment@35 {
		target = <&odm>;

		__overlay__ {

			hall_pen_detect {
				status = "okay";
				compatible = "hall,hall_pen_detect";
				pinctrl-names = "default", "sleep";
				pinctrl-0 = <&pen_int_default>;
				pinctrl-1 = <&pen_int_sleep>;
				hall,factory-class-name = "hall_1";
				hall,input-dev-name = "pen_hall_effect_sensor";
				hall_vdd-supply = <&mt6363_vio18>;
				hall,nirq-gpio-num = <0x02>;
				hall,nirq-gpio_0 = <&pio>, <0x3f 0x02>;
				hall,nirq-gpio-high-val_0 = <0x00>;
				hall,nirq-gpio-low-val_0 = <0x01>;
				hall,nirq-gpio_1 = <&pio>, <0x40 0x02>;
				hall,nirq-gpio-high-val_1 = <0x00>;
				hall,nirq-gpio-low-val_1 = <0x02>;
			};
		};
	};

	fragment@36 {
		target = <&odm>;

		__overlay__ {

			hall_folio_detect {
				status = "okay";
				compatible = "hall,hall_folio_detect";
				pinctrl-names = "default", "sleep";
				pinctrl-0 = <&folio_int_default>;
				pinctrl-1 = <&folio_int_sleep>;
				hall,factory-class-name = "hall_0";
				hall,input-dev-name = "folio_hall_effect_sensor";
				hall_vdd-supply = <&mt6363_vio18>;
				hall,nirq-gpio-num = <0x02>;
				hall,nirq-gpio_0 = <&pio>, <0x20 0x02>;
				hall,nirq-gpio-high-val_0 = <0x00>;
				hall,nirq-gpio-low-val_0 = <0x01>;
				hall,nirq-gpio_1 = <&pio>, <0x21 0x02>;
				hall,nirq-gpio-high-val_1 = <0x00>;
				hall,nirq-gpio-low-val_1 = <0x02>;
			};
		};
	};

	fragment@37 {
		target = <&i2c6>;

		__overlay__ {

			wl2864c: wl2864c@29 {
				status = "ok";
				compatible = "wl2864c";
				reg = <0x29>;
				semi,cs-gpios = <&pio>, <0xa8 0x00>;
				regulator_nb = "ldo1", "ldo2", "ldo3", "ldo4", "ldo5", "ldo6", "ldo7";
				phandle = <0x83>;

				regulators {

					cam_fm_dvdd_ldo: ldo1 {
						regulator-name = "wl2864c-ldo1";
						regulator-min-microvolt = <0x927c0>;
						regulator-max-microvolt = <0x39caec>;
						phandle = <0x6b>;
					};

					cam_uw_dvdd_ldo: ldo2 {
						regulator-name = "wl2864c-ldo2";
						regulator-min-microvolt = <0x927c0>;
						regulator-max-microvolt = <0x39caec>;
						phandle = <0x75>;
					};

					cam_uw_avdd_ldo: ldo3 {
						regulator-name = "wl2864c-ldo3";
						regulator-min-microvolt = <0x124f80>;
						regulator-max-microvolt = <0x42f2ac>;
						regulator-active-discharge;
						phandle = <0x74>;
					};

					cam_main_afdd_ldo: ldo4 {
						regulator-name = "wl2864c-ldo4";
						regulator-min-microvolt = <0x124f80>;
						regulator-max-microvolt = <0x42f2ac>;
						phandle = <0x50>;
					};

					cam_fm_avdd_ldo: ldo5 {
						regulator-name = "wl2864c-ldo5";
						regulator-min-microvolt = <0x2ab980>;
						regulator-max-microvolt = <0x2ab980>;
						phandle = <0x6a>;
					};

					cam_uw_afvdd_ldo: ldo6 {
						regulator-name = "wl2864c-ldo6";
						regulator-min-microvolt = <0x2ab980>;
						regulator-max-microvolt = <0x2ab980>;
						regulator-active-discharge;
						phandle = <0x52>;
					};

					cam_iovdd_ldo: ldo7 {
						regulator-name = "wl2864c-ldo7";
						regulator-min-microvolt = <0x124f80>;
						regulator-max-microvolt = <0x42f2ac>;
						phandle = <0x61>;
					};
				};
			};
		};
	};

	fragment@38 {
		target = <&rt6160>;

		__overlay__ {
			status = "disabled";
		};
	};

	fragment@39 {
		target = <&ps5169>;

		__overlay__ {
			status = "disabled";
		};
	};

	fragment@40 {
		target = <&gate_ic>;

		__overlay__ {
			status = "disabled";
		};
	};

	fragment@41 {
		target = <&i2c6>;

		__overlay__ {
			clock-frequency = <0x61a80>;

			aw882xx_smartpa_1: aw882xx@35 {
				compatible = "awinic,aw882xx_smartpa";
				#sound-dai-cells = <0x00>;
				reg = <0x35>;
				irq-gpio = <&pio>, <0x3e 0x00>;
				rcv-gpio = <&pio>, <0xa2 0x00>;
				sound-channel = <0x00>;
				vcalb_half = "true";
				status = "okay";
				phandle = <0x42>;
			};

			aw882xx_smartpa_0: aw882xx@34 {
				compatible = "awinic,aw882xx_smartpa";
				#sound-dai-cells = <0x00>;
				reg = <0x34>;
				irq-gpio = <&pio>, <0x04 0x00>;
				sound-channel = <0x01>;
				vcalb_half = "true";
				status = "okay";
				phandle = <0x43>;
			};

			fsa4480_switch: fsa4480@42 {
				compatible = "fsa,fsa4480-i2c";
				reg = <0x42>;
				phandle = <0x84>;
			};
		};
	};

	fragment@42 {
		target = <&sound>;

		__overlay__ {
			mediatek,spk-i2s = <0x01 0x0b>;

			mediatek,speaker-codec {
				sound-dai = <&aw882xx_smartpa_1>, <&aw882xx_smartpa_0>;
			};
		};
	};

	fragment@43 {
		target = <&regulator_vibrator>;

		__overlay__ {
			status = "ok";
			min-volt = <0x2932e0>;
			max-volt = <0x2932e0>;
		};
	};

	fragment@44 {
		target = <&clock_buffer_ctrl>;

		__overlay__ {
			mediatek,xo-bbck4 = <0x01>;
		};
	};

	fragment@45 {
		target = <&i2c3>;

		__overlay__ {
			status = "okay";
			clock-frequency = <0x61a80>;

			nfc_pn5xx: nfc_pn5xx@28 {
				compatible = "qcom,sn-nci";
				reg = <0x28>;
				interrupt-parent = <&pio>;
				interrupts = <0x13 0x04 0x01 0x00>;
				qcom,sn-irq = <&pio>, <0x13 0x00>;
				qcom,sn-ven = <&pio>, <0x0d 0x00>;
				status = "okay";
				phandle = <0x85>;
			};
		};
	};

	fragment@46 {
		target = <&spi5>;

		__overlay__ {

			p61: p61@0 {
				compatible = "nxp,p61";
				reg = <0x00>;
				spi-max-frequency = <0x1312d00>;
				nxp,nfcc = "3-0028";
				pinctrl-names = "pinctrl_state_mode_spi", "pinctrl_state_mode_idle";
				pinctrl-0 = <&pinctrl_state_mode_spi>;
				pinctrl-1 = <&pinctrl_state_mode_idle>;
				status = "okay";
				phandle = <0x86>;
			};
		};
	};

	fragment@47 {
		target = <&pio>;

		__overlay__ {

			pinctrl_state_mode_spi: pinctrl_state_mode_spi {
				phandle = <0x44>;

				pins_cmd_dat {
					pinmux = <0x4f01 0x5001 0x5101 0x5201>;
					drive-strength = <0x02>;
				};
			};

			pinctrl_state_mode_idle: pinctrl_state_mode_idle {
				phandle = <0x45>;

				pins_cmd_dat {
					pinmux = <0x5000>;
					slew-rate = <0x01>;
					output-high;
				};
			};
		};
	};

	fragment@48 {
		target = <&spi1>;

		__overlay__ {
			status = "okay";
			tee-only;
			mediatek,pad-select = <0x00 0x01>;

			fingerprint@0 {
				compatible = "mediatek,fingerprint";
				reg = <0x00>;
				spi-max-frequency = <0x7a1200>;
				status = "okay";
			};

			goodix_tee@0 {
				status = "okay";
				compatible = "goodix,goodix-fp";
				reg = <0x01>;
				spi-max-frequency = <0x7a1200>;
				netlink-event = <0x1e>;
			};
		};
	};

	fragment@49 {
		target = <&soc>;

		__overlay__ {

			fp_egistec {
				compatible = "fp-egistec";
				interrupt-parent = <&pio>;
				interrupts = <0x18 0x01 0x18 0x00>;
				fp-ctrl-power;
				egistec,gpio_reset = <&pio>, <0x07 0x00>;
				egistec,gpio_irq = <&pio>, <0x18 0x00>;
				vcc_fp-supply = <&mt6368_vfp>;
				egis-fp,vcc-voltage = <0x325aa0 0x325aa0>;
				egis-fp,vcc-current = <0x186a0>;
				pinctrl-names = "egis_rst_high", "egis_rst_low", "egis_irq_active", "egis_spi_active", "egis_spi_default";
				pinctrl-0 = <&fingerfp_rst_high>;
				pinctrl-1 = <&fingerfp_rst_low>;
				pinctrl-2 = <&fingerfp_irq_active>;
				pinctrl-3 = <&fingerfp_spi_active>;
				pinctrl-4 = <&fingerfp_spi_default>;
				status = "okay";
			};

			goodix_fp: goodix_fp {
				compatible = "mediatek,fingerprint-goodix";
				interrupt-parent = <&pio>;
				interrupts = <0x18 0x01 0x18 0x00>;
				rgltr-ctrl-support;
				fp,vdd-supply = <&mt6368_vfp>;
				fp,voltage-range = <0x325aa0 0x325aa0>;
				pinctrl-names = "fingerprint_irq", "fingerprint_reset_high", "fingerprint_reset_low";
				pinctrl-0 = <&fingerfp_irq_active>;
				pinctrl-1 = <&fingerfp_rst_high>;
				pinctrl-2 = <&fingerfp_rst_low>;
				int-gpios = <&pio>, <0x18 0x00>;
				status = "okay";
				phandle = <0x87>;
			};

			charge_led {
				label = "red";
				led_mode = <0x02>;
				gpio_config = <0xa3>;
			};
		};
	};

	fragment@50 {
		target = <&tboard_thermistor4>;

		__overlay__ {
			compatible = "mediatek,mt6879-board-ntc";
			#thermal-sensor-cells = <0x00>;
			io-channels = <&mt6368_adc>, <0x313>;
			io-channel-names = "Charger_NTC";
			temperature-lookup-table = <0xffff63c0 0x43183f 0xffff67a8 0x3e73ca 0xffff6b90 0x3a2985 0xffff6f78 0x363205 0xffff7360 0x328684 0xffff7748 0x2f20d7 0xffff7b30 0x2bfb5c 0xffff7f18 0x2910ee 0xffff8300 0x265cd9 0xffff86e8 0x23dad2 0xffff8ad0 0x2186e9 0xffff8eb8 0x1f5d86 0xffff92a0 0x1d5b5c 0xffff9688 0x1b7d65 0xffff9a70 0x19c0dd 0xffff9e58 0x182339 0xffffa240 0x16a15c 0xffffa628 0x153a09 0xffffaa10 0x13eb45 0xffffadf8 0x12b33b 0xffffb1e0 0x11903d 0xffffb5c8 0x1080bf 0xffffb9b0 0xf8355 0xffffbd98 0xe96b0 0xffffc180 0xdb999 0xffffc568 0xceaf3 0xffffc950 0xc29b7 0xffffcd38 0xb74f2 0xffffd120 0xacbc4 0xffffd508 0xa2d5c 0xffffd8f0 0x998fc 0xffffdcd8 0x90dbe 0xffffe0c0 0x88b3b 0xffffe4a8 0x810da 0xffffe890 0x79e0c 0xffffec78 0x73250 0xfffff060 0x6cd4c 0xfffff448 0x66e68 0xfffff830 0x6153c 0xfffffc18 0x5c169 0x00 0x57294 0x3e8 0x52856 0x7d0 0x4e27a 0xbb8 0x4a0b7 0xfa0 0x462ca 0x1388 0x42874 0x1770 0x3f17a 0x1b58 0x3bda8 0x1f40 0x38cc9 0x2328 0x35eaf 0x2710 0x3332e 0x2af8 0x30a1c 0x2ee0 0x2e354 0x32c8 0x2beb2 0x36b0 0x29c13 0x3a98 0x27b5b 0x3e80 0x25c66 0x4268 0x23f20 0x4650 0x2236e 0x4a38 0x20938 0x4e20 0x1f068 0x5208 0x1d8ea 0x55f0 0x1c2a8 0x59d8 0x1ad92 0x5dc0 0x19994 0x61a8 0x186a0 0x6590 0x174a6 0x6978 0x16398 0x6d60 0x15369 0x7148 0x1440c 0x7530 0x13576 0x7918 0x1279b 0x7d00 0x11a72 0x80e8 0x10df0 0x84d0 0x1020d 0x88b8 0xf6bf 0x8ca0 0xebff 0x9088 0xe1c5 0x9470 0xd80a 0x9858 0xcec6 0x9c40 0xc5f5 0xa028 0xbd90 0xa410 0xb592 0xa7f8 0xadf5 0xabe0 0xa6b3 0xafc8 0x9fc8 0xb3b0 0x992d 0xb798 0x92e1 0xbb80 0x8cdf 0xbf68 0x8723 0xc350 0x81ab 0xc738 0x7c73 0xcb20 0x7778 0xcf08 0x72b6 0xd2f0 0x6e2b 0xd6d8 0x69d3 0xdac0 0x65ac 0xdea8 0x61b5 0xe290 0x5dea 0xe678 0x5a49 0xea60 0x56d0 0xee48 0x537e 0xf230 0x5050 0xf618 0x4d46 0xfa00 0x4a5c 0xfde8 0x4792 0x101d0 0x44e8 0x105b8 0x425a 0x109a0 0x3fe8 0x10d88 0x3d8f 0x11170 0x3b50 0x11558 0x3927 0x11940 0x3714 0x11d28 0x3517 0x12110 0x332f 0x124f8 0x315b 0x128e0 0x2f9b 0x12cc8 0x2dec 0x130b0 0x2c4f 0x13498 0x2ac2 0x13880 0x2945 0x13c68 0x27d7 0x14050 0x2677 0x14438 0x2525 0x14820 0x23e0 0x14c08 0x22a8 0x14ff0 0x217c 0x153d8 0x205b 0x157c0 0x1f45 0x15ba8 0x1e3a 0x15f90 0x1d39 0x16378 0x1c42 0x16760 0x1b55 0x16b48 0x1a71 0x16f30 0x1994 0x17318 0x18c1 0x17700 0x17f4 0x17ae8 0x172e 0x17ed0 0x1670 0x182b8 0x15b9 0x186a0 0x1508 0x18a88 0x145e 0x18e70 0x13bb 0x19258 0x131d 0x19640 0x1285 0x19a28 0x11f2 0x19e10 0x1165 0x1a1f8 0x10dc 0x1a5e0 0x1058 0x1a9c8 0xfd9 0x1adb0 0xf5e 0x1b198 0xee8 0x1b580 0xe75 0x1b968 0xe07 0x1bd50 0xd9c 0x1c138 0xd34 0x1c520 0xcd1 0x1c908 0xc71 0x1ccf0 0xc15 0x1d0d8 0xbbb 0x1d4c0 0xb64 0x1d8a8 0xb10 0x1dc90 0xabf 0x1e078 0xa70 0x1e460 0xa24 0x1e848 0x9da>;
		};
	};

	fragment@51 {
		target = <&tboard_thermistor5>;

		__overlay__ {
			compatible = "mediatek,mt6879-board-ntc";
			#thermal-sensor-cells = <0x00>;
			io-channels = <&mt6368_adc>, <0x314>;
			io-channel-names = "QUIET_NTC";
			temperature-lookup-table = <0xffff63c0 0x43183f 0xffff67a8 0x3e73ca 0xffff6b90 0x3a2985 0xffff6f78 0x363205 0xffff7360 0x328684 0xffff7748 0x2f20d7 0xffff7b30 0x2bfb5c 0xffff7f18 0x2910ee 0xffff8300 0x265cd9 0xffff86e8 0x23dad2 0xffff8ad0 0x2186e9 0xffff8eb8 0x1f5d86 0xffff92a0 0x1d5b5c 0xffff9688 0x1b7d65 0xffff9a70 0x19c0dd 0xffff9e58 0x182339 0xffffa240 0x16a15c 0xffffa628 0x153a09 0xffffaa10 0x13eb45 0xffffadf8 0x12b33b 0xffffb1e0 0x11903d 0xffffb5c8 0x1080bf 0xffffb9b0 0xf8355 0xffffbd98 0xe96b0 0xffffc180 0xdb999 0xffffc568 0xceaf3 0xffffc950 0xc29b7 0xffffcd38 0xb74f2 0xffffd120 0xacbc4 0xffffd508 0xa2d5c 0xffffd8f0 0x998fc 0xffffdcd8 0x90dbe 0xffffe0c0 0x88b3b 0xffffe4a8 0x810da 0xffffe890 0x79e0c 0xffffec78 0x73250 0xfffff060 0x6cd4c 0xfffff448 0x66e68 0xfffff830 0x6153c 0xfffffc18 0x5c169 0x00 0x57294 0x3e8 0x52856 0x7d0 0x4e27a 0xbb8 0x4a0b7 0xfa0 0x462ca 0x1388 0x42874 0x1770 0x3f17a 0x1b58 0x3bda8 0x1f40 0x38cc9 0x2328 0x35eaf 0x2710 0x3332e 0x2af8 0x30a1c 0x2ee0 0x2e354 0x32c8 0x2beb2 0x36b0 0x29c13 0x3a98 0x27b5b 0x3e80 0x25c66 0x4268 0x23f20 0x4650 0x2236e 0x4a38 0x20938 0x4e20 0x1f068 0x5208 0x1d8ea 0x55f0 0x1c2a8 0x59d8 0x1ad92 0x5dc0 0x19994 0x61a8 0x186a0 0x6590 0x174a6 0x6978 0x16398 0x6d60 0x15369 0x7148 0x1440c 0x7530 0x13576 0x7918 0x1279b 0x7d00 0x11a72 0x80e8 0x10df0 0x84d0 0x1020d 0x88b8 0xf6bf 0x8ca0 0xebff 0x9088 0xe1c5 0x9470 0xd80a 0x9858 0xcec6 0x9c40 0xc5f5 0xa028 0xbd90 0xa410 0xb592 0xa7f8 0xadf5 0xabe0 0xa6b3 0xafc8 0x9fc8 0xb3b0 0x992d 0xb798 0x92e1 0xbb80 0x8cdf 0xbf68 0x8723 0xc350 0x81ab 0xc738 0x7c73 0xcb20 0x7778 0xcf08 0x72b6 0xd2f0 0x6e2b 0xd6d8 0x69d3 0xdac0 0x65ac 0xdea8 0x61b5 0xe290 0x5dea 0xe678 0x5a49 0xea60 0x56d0 0xee48 0x537e 0xf230 0x5050 0xf618 0x4d46 0xfa00 0x4a5c 0xfde8 0x4792 0x101d0 0x44e8 0x105b8 0x425a 0x109a0 0x3fe8 0x10d88 0x3d8f 0x11170 0x3b50 0x11558 0x3927 0x11940 0x3714 0x11d28 0x3517 0x12110 0x332f 0x124f8 0x315b 0x128e0 0x2f9b 0x12cc8 0x2dec 0x130b0 0x2c4f 0x13498 0x2ac2 0x13880 0x2945 0x13c68 0x27d7 0x14050 0x2677 0x14438 0x2525 0x14820 0x23e0 0x14c08 0x22a8 0x14ff0 0x217c 0x153d8 0x205b 0x157c0 0x1f45 0x15ba8 0x1e3a 0x15f90 0x1d39 0x16378 0x1c42 0x16760 0x1b55 0x16b48 0x1a71 0x16f30 0x1994 0x17318 0x18c1 0x17700 0x17f4 0x17ae8 0x172e 0x17ed0 0x1670 0x182b8 0x15b9 0x186a0 0x1508 0x18a88 0x145e 0x18e70 0x13bb 0x19258 0x131d 0x19640 0x1285 0x19a28 0x11f2 0x19e10 0x1165 0x1a1f8 0x10dc 0x1a5e0 0x1058 0x1a9c8 0xfd9 0x1adb0 0xf5e 0x1b198 0xee8 0x1b580 0xe75 0x1b968 0xe07 0x1bd50 0xd9c 0x1c138 0xd34 0x1c520 0xcd1 0x1c908 0xc71 0x1ccf0 0xc15 0x1d0d8 0xbbb 0x1d4c0 0xb64 0x1d8a8 0xb10 0x1dc90 0xabf 0x1e078 0xa70 0x1e460 0xa24 0x1e848 0x9da>;
		};
	};

	fragment@52 {
		target = <&tboard_thermistor6>;

		__overlay__ {
			compatible = "mediatek,mt6879-board-ntc";
			#thermal-sensor-cells = <0x00>;
			io-channels = <&pmic_adc>, <0x13>;
			io-channel-names = "TSPK_NTC";
			temperature-lookup-table = <0xffff63c0 0x43183f 0xffff67a8 0x3e73ca 0xffff6b90 0x3a2985 0xffff6f78 0x363205 0xffff7360 0x328684 0xffff7748 0x2f20d7 0xffff7b30 0x2bfb5c 0xffff7f18 0x2910ee 0xffff8300 0x265cd9 0xffff86e8 0x23dad2 0xffff8ad0 0x2186e9 0xffff8eb8 0x1f5d86 0xffff92a0 0x1d5b5c 0xffff9688 0x1b7d65 0xffff9a70 0x19c0dd 0xffff9e58 0x182339 0xffffa240 0x16a15c 0xffffa628 0x153a09 0xffffaa10 0x13eb45 0xffffadf8 0x12b33b 0xffffb1e0 0x11903d 0xffffb5c8 0x1080bf 0xffffb9b0 0xf8355 0xffffbd98 0xe96b0 0xffffc180 0xdb999 0xffffc568 0xceaf3 0xffffc950 0xc29b7 0xffffcd38 0xb74f2 0xffffd120 0xacbc4 0xffffd508 0xa2d5c 0xffffd8f0 0x998fc 0xffffdcd8 0x90dbe 0xffffe0c0 0x88b3b 0xffffe4a8 0x810da 0xffffe890 0x79e0c 0xffffec78 0x73250 0xfffff060 0x6cd4c 0xfffff448 0x66e68 0xfffff830 0x6153c 0xfffffc18 0x5c169 0x00 0x57294 0x3e8 0x52856 0x7d0 0x4e27a 0xbb8 0x4a0b7 0xfa0 0x462ca 0x1388 0x42874 0x1770 0x3f17a 0x1b58 0x3bda8 0x1f40 0x38cc9 0x2328 0x35eaf 0x2710 0x3332e 0x2af8 0x30a1c 0x2ee0 0x2e354 0x32c8 0x2beb2 0x36b0 0x29c13 0x3a98 0x27b5b 0x3e80 0x25c66 0x4268 0x23f20 0x4650 0x2236e 0x4a38 0x20938 0x4e20 0x1f068 0x5208 0x1d8ea 0x55f0 0x1c2a8 0x59d8 0x1ad92 0x5dc0 0x19994 0x61a8 0x186a0 0x6590 0x174a6 0x6978 0x16398 0x6d60 0x15369 0x7148 0x1440c 0x7530 0x13576 0x7918 0x1279b 0x7d00 0x11a72 0x80e8 0x10df0 0x84d0 0x1020d 0x88b8 0xf6bf 0x8ca0 0xebff 0x9088 0xe1c5 0x9470 0xd80a 0x9858 0xcec6 0x9c40 0xc5f5 0xa028 0xbd90 0xa410 0xb592 0xa7f8 0xadf5 0xabe0 0xa6b3 0xafc8 0x9fc8 0xb3b0 0x992d 0xb798 0x92e1 0xbb80 0x8cdf 0xbf68 0x8723 0xc350 0x81ab 0xc738 0x7c73 0xcb20 0x7778 0xcf08 0x72b6 0xd2f0 0x6e2b 0xd6d8 0x69d3 0xdac0 0x65ac 0xdea8 0x61b5 0xe290 0x5dea 0xe678 0x5a49 0xea60 0x56d0 0xee48 0x537e 0xf230 0x5050 0xf618 0x4d46 0xfa00 0x4a5c 0xfde8 0x4792 0x101d0 0x44e8 0x105b8 0x425a 0x109a0 0x3fe8 0x10d88 0x3d8f 0x11170 0x3b50 0x11558 0x3927 0x11940 0x3714 0x11d28 0x3517 0x12110 0x332f 0x124f8 0x315b 0x128e0 0x2f9b 0x12cc8 0x2dec 0x130b0 0x2c4f 0x13498 0x2ac2 0x13880 0x2945 0x13c68 0x27d7 0x14050 0x2677 0x14438 0x2525 0x14820 0x23e0 0x14c08 0x22a8 0x14ff0 0x217c 0x153d8 0x205b 0x157c0 0x1f45 0x15ba8 0x1e3a 0x15f90 0x1d39 0x16378 0x1c42 0x16760 0x1b55 0x16b48 0x1a71 0x16f30 0x1994 0x17318 0x18c1 0x17700 0x17f4 0x17ae8 0x172e 0x17ed0 0x1670 0x182b8 0x15b9 0x186a0 0x1508 0x18a88 0x145e 0x18e70 0x13bb 0x19258 0x131d 0x19640 0x1285 0x19a28 0x11f2 0x19e10 0x1165 0x1a1f8 0x10dc 0x1a5e0 0x1058 0x1a9c8 0xfd9 0x1adb0 0xf5e 0x1b198 0xee8 0x1b580 0xe75 0x1b968 0xe07 0x1bd50 0xd9c 0x1c138 0xd34 0x1c520 0xcd1 0x1c908 0xc71 0x1ccf0 0xc15 0x1d0d8 0xbbb 0x1d4c0 0xb64 0x1d8a8 0xb10 0x1dc90 0xabf 0x1e078 0xa70 0x1e460 0xa24 0x1e848 0x9da>;
		};
	};

	fragment@53 {
		target = <&thermal_zones>;

		__overlay__ {

			chg_ntc: chg_ntc {
				polling-delay = <0x00>;
				polling-delay-passive = <0x00>;
				thermal-sensors = <&tboard_thermistor4>;
				phandle = <0x88>;
			};

			quiet_ntc: quiet_ntc {
				polling-delay = <0x00>;
				polling-delay-passive = <0x00>;
				thermal-sensors = <&tboard_thermistor5>;
				phandle = <0x89>;
			};

			tspk_ntc: tspk_ntc {
				polling-delay = <0x00>;
				polling-delay-passive = <0x00>;
				thermal-sensors = <&tboard_thermistor6>;
				phandle = <0x8a>;
			};
		};
	};

	fragment@54 {
		target = <&therm_intf>;

		__overlay__ {
			mmi,temperature-names = "BACK_TEMP", "FRONT_TEMP";
		};
	};

	fragment@55 {
		target = <&pio>;

		__overlay__ {

			vibrator_irq_input: vibrator_irq_input {
				phandle = <0x8b>;

				pins_cmd_dat {
					pinmux = <0x600>;
					slew-rate = <0x00>;
					input-enable;
					bias-pull-up;
				};
			};

			fingerfp_rst_high: fingerfp_rst_high {
				phandle = <0x46>;

				pins_cmd_dat {
					pinmux = <0x700>;
					slew-rate = <0x01>;
					output-high;
				};
			};

			fingerfp_rst_low: fingerfp_rst_low {
				phandle = <0x47>;

				pins_cmd_dat {
					pinmux = <0x700>;
					slew-rate = <0x01>;
					output-low;
				};
			};

			fingerfp_irq_active: fingerfp_irq_active {
				phandle = <0x48>;

				pins_cmd_dat {
					pinmux = <0x1800>;
					slew-rate = <0x00>;
					bias-disable;
				};
			};

			fingerfp_spi_active: fingerfp_spi_active {
				phandle = <0x49>;

				pins_cmd_dat {
					pinmux = <0x4602 0x4402 0x4502 0x4302>;
					drive-strength = <0x02>;
				};
			};

			fingerfp_spi_default: fingerfp_spi_default {
				phandle = <0x4a>;

				pins_cmd_dat {
					pinmux = <0x4600 0x4400 0x4500 0x4300>;
					slew-rate = <0x01>;
					output-low;
				};
			};
		};
	};

	fragment@56 {
		target = <&u2port0>;

		__overlay__ {
			mediatek,eye-vrt = <0x04>;
			mediatek,rev6 = <0x02>;
			mediatek,discth = <0x08>;
		};
	};

	fragment@57 {
		target = <&mmc1>;

		__overlay__ {
			status = "disable";
		};
	};

	fragment@58 {
		target = <&swtp>;

		__overlay__ {
			interrupt-parent = <&pio>;
			interrupts = <0x0e 0x04 0x0e 0x00>;
			deb-gpios = <&pio>, <0x0e 0x00>;
			debounce = <0x200>;
			status = "okay";
		};
	};

	fragment@59 {
		target = <&swtp_1>;

		__overlay__ {
			interrupt-parent = <&pio>;
			interrupts = <0x0f 0x04 0x0f 0x00>;
			deb-gpios = <&pio>, <0x0f 0x00>;
			debounce = <0x200>;
			status = "okay";
		};
	};

	fragment@60 {
		target = <&swtp_2>;

		__overlay__ {
			interrupt-parent = <&pio>;
			interrupts = <0x11 0x04 0x11 0x00>;
			deb-gpios = <&pio>, <0x11 0x00>;
			debounce = <0x200>;
			status = "okay";
		};
	};

	fragment@61 {
		target = <&swtp_3>;

		__overlay__ {
			interrupt-parent = <&pio>;
			interrupts = <0x14 0x04 0x14 0x00>;
			deb-gpios = <&pio>, <0x14 0x00>;
			debounce = <0x200>;
			status = "okay";
		};
	};

	fragment@62 {
		target = <&swtp_4>;

		__overlay__ {
			interrupt-parent = <&pio>;
			interrupts = <0x15 0x04 0x15 0x00>;
			deb-gpios = <&pio>, <0x15 0x00>;
			debounce = <0x200>;
			status = "okay";
		};
	};

	fragment@63 {
		target = <&swtp_5>;

		__overlay__ {
			interrupt-parent = <&pio>;
			interrupts = <0x1e 0x04 0x1e 0x00>;
			deb-gpios = <&pio>, <0x1e 0x00>;
			debounce = <0x200>;
			status = "okay";
		};
	};

	fragment@64 {
		target = <&swtp_6>;

		__overlay__ {
			interrupt-parent = <&pio>;
			interrupts = <0x7c 0x04 0x7c 0x00>;
			deb-gpios = <&pio>, <0x7c 0x00>;
			debounce = <0x200>;
			status = "okay";
		};
	};

	fragment@65 {
		target = <&mtee_svp>;

		__overlay__ {

			mtee: MTEE {
				compatible = "mediatek,mtk_svp_on_mtee_support";
				phandle = <0x8c>;
			};

			svp: SecureVideoPath {
				compatible = "mediatek,mtk_sec_video_path_support";
				phandle = <0x8d>;
			};
		};
	};

	fragment@66 {
		target = <&i2c5>;

		__overlay__ {
			status = "okay";
		};
	};

	fragment@67 {
		target = <&mtk_gauge>;

		__overlay__ {
			status = "disabled";
		};
	};

	fragment@68 {
		target = <&mt6375_typec>;

		__overlay__ {
			tcpc,en_wd;
			tcpc,en_wd_sbu_polling;
			tcpc,en_wd_polling_only;
		};
	};

	fragment@69 {
		target = <&mt6375_chg>;

		__overlay__ {
			ircmp_r = <0x00>;
			ircmp_v = <0x00>;
		};
	};

	fragment@70 {
		target = <&lk_charger>;

		__overlay__ {
			usb_charger_current = <0x7a120>;
			ac_charger_current = <0xf4240>;
			ac_charger_input_current = <0x1e8480>;
			non_std_ac_charger_current = <0xf4240>;
			charging_host_input_current = <0x16e360>;
			charging_host_charger_current = <0xf4240>;
			pre_charge_current = <0x190>;
			temp_t4_threshold = <0x3c>;
			ac_charger_boot_battery_voltage = <0x33e140>;
		};
	};

	fragment@71 {
		target = <&mtk_ctd>;

		__overlay__ {
			bootmode = <&chosen>;
		};
	};

	fragment@72 {
		target = <&charger>;

		__overlay__ {
			gauge = <&smart_battery>;
			battery_cv = <0x44aa20>;
			max_charger_voltage = <0xdd40a0>;
			ac_charger_current = <0x2dc6c0>;
			usb_charger_current = <0x7a120>;
			ac_charger_input_current = <0x1e8480>;
			charging_host_charger_current = <0x16e360>;
			fast_charging_indicator = <0x16>;
			charger_configuration = <0x04>;
			disable_aicl;
			enable_dynamic_mivr;
			mmi,typec-rp-max-current = <0x1e8480>;
			mmi,iterm-ma = <0x1b6>;
			mmi,mmi-temp-zones = <0x00 0x1068 0x3e8 0x00 0x0a 0x109a 0xfa0 0x7d0 0x0f 0x00 0xfa0 0xfa0 0x2d 0x109a 0x2fa8 0x2710 0x2d 0x10cc 0x2710 0x1f40 0x2d 0x1130 0x1f40 0x1770 0x2d 0x1162 0x1770 0x12f2 0x3c 0x1068 0x12f2 0x00>;
			mmi,mmi-ffc-zones = <0x00 0x1068 0x1b6 0x0a 0x1194 0x1b6 0x0f 0x1194 0x1b6 0x19 0x11b2 0x2e5 0x23 0x11b2 0x343 0x2d 0x11b2 0x497 0x3c 0x1068 0x1b6>;
			mmi,enable-charging-limit;
			mmi,upper-limit-capacity = <0x41>;
			mmi,lower-limit-capacity = <0x3c>;
			mmi,min-cp-therm-current-ua = <0x1e8480>;
			mmi,pd-pmax-mw = <0x109a0>;
			mmi,pd_vbus_low_bound = <0x4c4b40>;
			mmi,pd_vbus_upper_bound = <0x895440>;
		};
	};

	fragment@73 {
		target = <&moto_chg_tcmd>;

		__overlay__ {
			compatible = "mmi,moto-chg-tcmd";
			status = "okay";
			mmi,ntc_table = <0x01>;
			mmi,ntc_v_ref = <0x1b7740>;
			mmi,ntc_r_pull = <0x186a0>;
			mmi,batid_v_ref = <0x1b7740>;
			mmi,batid_r_pull = <0x186a0>;
			mmi,adc-channel-cpu = <0x00>;
			mmi,adc-channel-charger = <0x02>;
			mmi,adc-channel-pa = <0x01>;
			mmi,adc-channel-batid = <0x03>;
			mmi,adc-channel-vbat = <0x64>;
		};
	};

	fragment@74 {
		target = <&smart_battery>;

		__overlay__ {
			compatible = "mmi,smart-battery";
			status = "okay";
			mmi,sync_boardtemp_to_fg;
			mmi,ui_full_soc = <0x61>;
			mmi,shutdown_vol_threshold = <0xd48>;
			mmi,soc100_curr_threshod = <0x1cfde0>;
		};
	};

	fragment@75 {
		target = <&pio>;

		__overlay__ {

			bq25960_int_default_master: bq25960_int_default_master {
				pinmux = <0x7500>;
				slew-rate = <0x00>;
				input-enable;
				bias-pull-up;
				phandle = <0x4b>;
			};

			bq25960_int_default_slave: bq25960_int_default_slave {
				pinmux = <0x7a00>;
				slew-rate = <0x00>;
				input-enable;
				bias-pull-up;
				phandle = <0x4c>;
			};
		};
	};

	fragment@76 {
		target = <&i2c0>;

		__overlay__ {
			status = "okay";

			NFG1000: NFG1000@55 {
				compatible = "HXZY,nfg1000";
				reg = <0x55>;
				io-channels = <&mt6375_auxadc>, <0x01>, <&mt6375_auxadc>, <0x04>;
				io-channel-names = "bat_temp", "vref";
				uirbat_pull_up_r_full = <0x5dc0>;
				latest_fw_version = [01 02 08 52 34];
				batt_serialnums = "SB18D87942", "SB18D87943";
				batt_versions = <0x50003>;
				phandle = <0x8e>;
			};

			bq25960_master: bq25960-master@66 {
				status = "okay";
				compatible = "ti,bq25960-master";
				reg = <0x66>;
				sc8541-addr = <0x6b>;
				sc8541-name = "sc8541-master";
				interrupt-parent = <&pio>;
				interrupts = <0x75 0x02 0x75 0x00>;
				interrupt-names = "bq25960_irq_master";
				pinctrl-names = "default";
				pinctrl-0 = <&bq25960_int_default_master>;
				phandle = <0x8f>;
			};

			bq25960_slave: bq25960-slave@67 {
				status = "okay";
				compatible = "ti,bq25960-slave";
				reg = <0x67>;
				sc8541-addr = <0x6c>;
				sc8541-name = "sc8541-slave";
				interrupt-parent = <&pio>;
				interrupts = <0x7a 0x02 0x7a 0x00>;
				interrupt-names = "bq25960_irq_slave";
				pinctrl-names = "default";
				pinctrl-0 = <&bq25960_int_default_slave>;
				phandle = <0x90>;
			};
		};
	};

	fragment@77 {
		target = <&pd_adapter>;

		__overlay__ {
			ita_min = <0x3e8>;
		};
	};

	fragment@78 {
		target = <&pdc>;

		__overlay__ {
			compatible = "mediatek,charger,pd";
			gauge = <&smart_battery>;
			min_charger_voltage = <0x4630c0>;
			pd_vbus_low_bound = <0x4c4b40>;
			pd_vbus_upper_bound = <0x895440>;
			vsys_watt = <0x4c4b40>;
			ibus_err = <0x0e>;
			pd_stop_battery_soc = <0x50>;
			sc_input_current = <0x2dc6c0>;
			sc_charger_current = <0x2dc6c0>;
			dcs_input_current = <0x30d400>;
			dcs_chg1_charger_current = <0x16e360>;
			dcs_chg2_charger_current = <0x16e360>;
			dual_polling_ieoc = <0x6ddd0>;
			slave_mivr_diff = <0x186a0>;
			vbat_threshold = <0x1036>;
		};
	};

	fragment@79 {
		target = <&pe>;

		__overlay__ {
			gauge = <&smart_battery>;
		};
	};

	fragment@80 {
		target = <&pe4>;

		__overlay__ {
			gauge = <&smart_battery>;
		};
	};

	fragment@81 {
		target = <&pe2>;

		__overlay__ {
			compatible = "mediatek,charger,pe2";
			gauge = <&smart_battery>;
			pe20_ichg_level_threshold = <0xf4240>;
			ta_start_battery_soc = <0x00>;
			ta_stop_battery_soc = <0x55>;
			min_charger_voltage = <0x4630c0>;
			charger_voltage = <0x895440>;
			cable_imp_threshold = <0x2bb>;
			vbat_cable_imp_threshold = <0x3b8260>;
			sc_input_current = <0x186a00>;
			sc_charger_current = <0x2dc6c0>;
			dcs_input_current = <0x30d400>;
			dcs_chg1_charger_current = <0x16e360>;
			dcs_chg2_charger_current = <0x16e360>;
			dual_polling_ieoc = <0x6ddd0>;
			slave_mivr_diff = <0x186a0>;
			vbat_threshold = <0x1036>;
		};
	};

	fragment@82 {
		target = <&pe5>;

		__overlay__ {
			compatible = "mediatek,charger,pe5";
			gauge = <&smart_battery>;
			polling_interval = <0x2710>;
			ta_cv_ss_repeat_tmin = <0x19>;
			vbat_cv = <0x11b2>;
			start_soc_min = <0x00>;
			start_soc_max = <0x5a>;
			start_vbat_max = <0x1162>;
			idvchg_term = <0x1f4>;
			idvchg_step = <0x32>;
			ita_level = <0xbb8 0x7d0 0x5dc 0x3e8>;
			rcable_level = <0xe6 0x104 0x12c 0x1e0>;
			ita_level_dual = <0x1838 0xbb8 0x7d0 0x5dc>;
			rcable_level_dual = <0xb4 0xe6 0x104 0x12c>;
			idvchg_ss_init = <0x3e8>;
			idvchg_ss_step = <0xfa>;
			idvchg_ss_step1 = <0x64>;
			idvchg_ss_step2 = <0x32>;
			idvchg_ss_step1_vbat = <0xfa0>;
			idvchg_ss_step2_vbat = <0x1068>;
			ta_blanking = <0x190>;
			swchg_aicr = <0x00>;
			swchg_ichg = <0x4b0>;
			swchg_aicr_ss_init = <0x190>;
			swchg_aicr_ss_step = <0xc8>;
			swchg_off_vbat = <0x109a>;
			force_ta_cv_vbat = <0x109a>;
			chg_time_max = <0x2a30>;
			tta_level_def = <0x00 0x00 0x00 0x00 0x19 0x32 0x3c 0x46 0x50>;
			tta_curlmt = <0x00 0x00 0x00 0x00 0x00 0x00 0x00 0x00 0x00>;
			tta_recovery_area = <0x03>;
			tbat_level_def = <0x00 0x00 0x00 0x05 0x19 0x28 0x2b 0x2e 0x32>;
			tbat_curlmt = <0x00 0x00 0x00 0x00 0x00 0x00 0x00 0x00 0x00>;
			tbat_recovery_area = <0x03>;
			tdvchg_level_def = <0x00 0x00 0x00 0x05 0x19 0x37 0x3c 0x41 0x46>;
			tdvchg_curlmt = <0x00 0x00 0x00 0x00 0x00 0x00 0x00 0x00 0x00>;
			tdvchg_recovery_area = <0x03>;
			tswchg_level_def = <0x00 0x00 0x00 0x05 0x19 0x41 0x46 0x4b 0x50>;
			tswchg_curlmt = <0x00 0x00 0x00 0x00 0x00 0x00 0x00 0x00 0x00>;
			tswchg_recovery_area = <0x03>;
			ifod_threshold = <0xc8>;
			rsw_min = <0x14>;
			ircmp_rbat = <0x28>;
			ircmp_vclamp = <0x00>;
			vta_cap_min = <0x1a90>;
			vta_cap_max = <0x2af8>;
			ita_cap_min = <0x3e8>;
			support_ta = "pca_ta_pps", "pd_adapter";
			allow_not_check_ta_status;
			vbat_threshold = <0x1036>;
			mmi_therm_cur_thres = <0x1f4>;
			mmi_therm_vol_thres = <0x50>;
			mmi_therm_step = <0x03>;
			mmi_max_ibat = <0x2fa8>;
			mmi_max_hrst_cnt = <0x01>;
		};
	};

	fragment@83 {
		target = <&mt6375_typec>;

		__overlay__ {

			pd-data {
				pd,source-pdo-data = <0x1905a>;
				pd,sink-pdo-size = <0x04>;
				pd,sink-pdo-data = <0x190c8 0x1912c 0x2d0c8 0x2d12c>;
			};
		};
	};

	fragment@84 {
		target = <&charge_leds>;

		__overlay__ {
			compatible = "gpio-leds";

			charging {
				label = "charging";
				gpios = <&pio>, <0xa3 0x00>;
				default-state = "off";
			};
		};
	};

	fragment@85 {
		target = <&charger_cooler>;

		__overlay__ {
			mmi,thermal-mitigation = <0xffffffff 0x7a1200 0x5b8d80 0x3d0900 0x2dc6c0 0x1e8480 0xf4240 0x7a120 0x493e0>;
		};
	};

	fragment@86 {
		target = <&extcon_usb>;

		__overlay__ {
			vbus-current = <0x13d620>;
		};
	};

	fragment@model {
		target-path = "/";

		__overlay__ {
			mot,model = "manaus";
			mot,board-id = <0x48 0xb1a0>;
		};
	};

	fragment@87 {
		target = <&gpio_usage_mapping>;

		__overlay__ {
			GPIO_SIM1_HOT_PLUG = <&pio>, <0x35 0x00>;
			GPIO_SIM2_HOT_PLUG = <&pio>, <0x36 0x00>;
			GPIO_SIM1_SCLK = <&pio>, <0x5a 0x00>;
			GPIO_SIM1_SRST = <&pio>, <0x5b 0x00>;
			GPIO_SIM1_SIO = <&pio>, <0x5c 0x00>;
			GPIO_SIM2_SCLK = <&pio>, <0x5d 0x00>;
			GPIO_SIM2_SRST = <&pio>, <0x5e 0x00>;
			GPIO_SIM2_SIO = <&pio>, <0x5f 0x00>;
			GPIO_FDD_BAND_SUPPORT_DETECT_2ND_PIN = <&pio>, <0x75 0x00>;
			GPIO_FDD_BAND_SUPPORT_DETECT_1ST_PIN = <&pio>, <0x7e 0x00>;
		};
	};

	fragment@88 {
		target = <&gpio>;

		__overlay__ {
			gpio_init_default = <0x00 0x00 0x01 0x00 0x01 0x00 0x01 0x01 0x00 0x00 0x00 0x01 0x00 0x00 0x02 0x00 0x00 0x00 0x01 0x00 0x01 0x03 0x00 0x00 0x00 0x01 0x01 0x01 0x04 0x00 0x00 0x00 0x01 0x01 0x01 0x05 0x03 0x00 0x00 0x01 0x00 0x00 0x06 0x00 0x00 0x00 0x01 0x01 0x00 0x07 0x00 0x00 0x00 0x01 0x00 0x00 0x08 0x01 0x00 0x00 0x01 0x00 0x01 0x09 0x07 0x00 0x00 0x01 0x00 0x01 0x0a 0x07 0x00 0x00 0x01 0x00 0x01 0x0b 0x07 0x00 0x00 0x01 0x00 0x01 0x0c 0x07 0x00 0x00 0x00 0x00 0x01 0x0d 0x00 0x00 0x00 0x01 0x00 0x01 0x0e 0x00 0x00 0x00 0x00 0x00 0x01 0x0f 0x00 0x00 0x00 0x00 0x00 0x01 0x10 0x00 0x00 0x00 0x01 0x00 0x01 0x11 0x00 0x00 0x00 0x00 0x00 0x01 0x12 0x00 0x00 0x00 0x01 0x00 0x01 0x13 0x00 0x00 0x00 0x01 0x00 0x01 0x14 0x00 0x00 0x00 0x00 0x00 0x01 0x15 0x00 0x00 0x00 0x00 0x00 0x01 0x16 0x00 0x00 0x00 0x01 0x01 0x01 0x17 0x01 0x00 0x00 0x01 0x00 0x01 0x18 0x00 0x00 0x00 0x01 0x01 0x01 0x19 0x00 0x00 0x00 0x00 0x00 0x01 0x1a 0x04 0x00 0x00 0x01 0x00 0x01 0x1b 0x00 0x00 0x00 0x01 0x00 0x01 0x1c 0x00 0x00 0x00 0x01 0x01 0x01 0x1d 0x00 0x00 0x00 0x01 0x01 0x01 0x1e 0x00 0x00 0x00 0x00 0x00 0x01 0x1f 0x00 0x00 0x00 0x01 0x01 0x01 0x20 0x00 0x01 0x00 0x01 0x00 0x01 0x21 0x00 0x01 0x00 0x01 0x00 0x01 0x22 0x00 0x00 0x00 0x01 0x00 0x01 0x23 0x00 0x00 0x00 0x01 0x00 0x01 0x24 0x01 0x00 0x00 0x00 0x00 0x01 0x25 0x01 0x00 0x00 0x00 0x00 0x01 0x26 0x01 0x00 0x00 0x00 0x00 0x01 0x27 0x03 0x00 0x00 0x01 0x00 0x01 0x28 0x01 0x00 0x00 0x01 0x00 0x01 0x29 0x01 0x00 0x00 0x01 0x00 0x01 0x2a 0x01 0x00 0x00 0x01 0x00 0x01 0x2b 0x01 0x00 0x00 0x01 0x00 0x01 0x2c 0x01 0x00 0x00 0x01 0x00 0x01 0x2d 0x01 0x00 0x00 0x01 0x00 0x01 0x2e 0x01 0x00 0x00 0x01 0x00 0x01 0x2f 0x01 0x00 0x00 0x01 0x00 0x01 0x30 0x06 0x00 0x00 0x01 0x00 0x01 0x31 0x06 0x00 0x00 0x01 0x00 0x01 0x32 0x06 0x00 0x00 0x01 0x00 0x01 0x33 0x06 0x00 0x00 0x01 0x00 0x01 0x34 0x06 0x00 0x00 0x01 0x00 0x01 0x35 0x01 0x00 0x00 0x01 0x01 0x01 0x36 0x01 0x00 0x00 0x01 0x01 0x01 0x37 0x01 0x00 0x00 0x01 0x00 0x01 0x38 0x01 0x00 0x00 0x01 0x01 0x01 0x39 0x02 0x00 0x00 0x01 0x00 0x01 0x3a 0x02 0x00 0x00 0x01 0x01 0x01 0x3b 0x00 0x01 0x00 0x01 0x00 0x01 0x3c 0x00 0x01 0x00 0x01 0x00 0x01 0x3d 0x01 0x00 0x00 0x01 0x01 0x01 0x3e 0x00 0x00 0x00 0x01 0x01 0x01 0x3f 0x01 0x00 0x00 0x00 0x00 0x01 0x40 0x01 0x00 0x00 0x00 0x00 0x01 0x41 0x01 0x00 0x00 0x00 0x00 0x01 0x42 0x01 0x00 0x00 0x01 0x00 0x01 0x43 0x02 0x00 0x00 0x00 0x00 0x01 0x44 0x02 0x00 0x00 0x00 0x00 0x01 0x45 0x02 0x00 0x00 0x00 0x00 0x01 0x46 0x02 0x00 0x00 0x01 0x00 0x01 0x47 0x01 0x00 0x00 0x00 0x00 0x01 0x48 0x01 0x00 0x00 0x00 0x00 0x01 0x49 0x01 0x00 0x00 0x00 0x00 0x01 0x4a 0x01 0x00 0x00 0x01 0x00 0x01 0x4b 0x02 0x00 0x00 0x00 0x00 0x01 0x4c 0x02 0x00 0x00 0x00 0x00 0x01 0x4d 0x02 0x00 0x00 0x00 0x00 0x01 0x4e 0x02 0x00 0x00 0x01 0x00 0x01 0x4f 0x00 0x00 0x00 0x01 0x00 0x00 0x50 0x00 0x00 0x00 0x01 0x00 0x00 0x51 0x00 0x00 0x00 0x01 0x00 0x00 0x52 0x00 0x00 0x00 0x01 0x00 0x00 0x53 0x00 0x00 0x00 0x01 0x00 0x00 0x54 0x01 0x00 0x00 0x00 0x00 0x01 0x55 0x01 0x00 0x00 0x01 0x01 0x01 0x56 0x01 0x00 0x00 0x01 0x01 0x01 0x57 0x01 0x00 0x00 0x01 0x01 0x01 0x58 0x01 0x00 0x00 0x01 0x01 0x01 0x59 0x01 0x00 0x00 0x01 0x01 0x01 0x5a 0x01 0x00 0x00 0x00 0x00 0x01 0x5b 0x01 0x00 0x00 0x00 0x00 0x01 0x5c 0x01 0x00 0x00 0x01 0x01 0x01 0x5d 0x01 0x00 0x00 0x00 0x00 0x01 0x5e 0x01 0x00 0x00 0x00 0x00 0x01 0x5f 0x01 0x00 0x00 0x01 0x01 0x01 0x60 0x01 0x00 0x00 0x01 0x00 0x01 0x61 0x00 0x00 0x00 0x00 0x00 0x01 0x62 0x00 0x01 0x00 0x01 0x00 0x01 0x63 0x01 0x00 0x00 0x00 0x00 0x01 0x64 0x01 0x00 0x00 0x00 0x00 0x01 0x65 0x01 0x00 0x00 0x00 0x00 0x01 0x66 0x01 0x00 0x00 0x00 0x00 0x01 0x67 0x00 0x01 0x00 0x01 0x00 0x01 0x68 0x00 0x01 0x00 0x01 0x00 0x01 0x69 0x01 0x00 0x00 0x01 0x00 0x01 0x6a 0x01 0x00 0x00 0x01 0x00 0x01 0x6b 0x00 0x00 0x00 0x01 0x00 0x00 0x6c 0x01 0x00 0x00 0x00 0x00 0x01 0x6d 0x01 0x00 0x00 0x00 0x00 0x01 0x6e 0x01 0x00 0x00 0x00 0x00 0x01 0x6f 0x01 0x00 0x00 0x00 0x00 0x01 0x70 0x01 0x00 0x00 0x00 0x00 0x01 0x71 0x01 0x00 0x00 0x00 0x00 0x01 0x72 0x01 0x00 0x00 0x00 0x00 0x01 0x73 0x01 0x00 0x00 0x00 0x00 0x01 0x74 0x01 0x00 0x00 0x00 0x00 0x01 0x75 0x00 0x00 0x00 0x01 0x01 0x00 0x76 0x01 0x00 0x00 0x00 0x00 0x01 0x77 0x01 0x00 0x00 0x00 0x00 0x01 0x78 0x00 0x01 0x00 0x01 0x00 0x01 0x79 0x00 0x01 0x00 0x01 0x00 0x01 0x7a 0x00 0x00 0x00 0x01 0x01 0x00 0x7b 0x03 0x00 0x00 0x01 0x00 0x00 0x7c 0x00 0x00 0x00 0x00 0x00 0x01 0x7d 0x01 0x00 0x00 0x00 0x00 0x01 0x7e 0x00 0x00 0x00 0x01 0x00 0x00 0x7f 0x01 0x00 0x00 0x00 0x00 0x01 0x80 0x01 0x00 0x00 0x00 0x00 0x01 0x81 0x01 0x00 0x00 0x00 0x00 0x00 0x82 0x01 0x00 0x00 0x01 0x00 0x00 0x83 0x01 0x00 0x00 0x00 0x00 0x00 0x84 0x01 0x00 0x00 0x01 0x00 0x00 0x85 0x01 0x00 0x00 0x00 0x00 0x00 0x86 0x01 0x00 0x00 0x01 0x00 0x00 0x87 0x00 0x01 0x00 0x01 0x00 0x01 0x88 0x00 0x01 0x00 0x01 0x00 0x01 0x89 0x01 0x00 0x00 0x01 0x00 0x01 0x8a 0x01 0x00 0x00 0x01 0x00 0x01 0x8b 0x01 0x00 0x00 0x01 0x01 0x01 0x8c 0x01 0x00 0x00 0x01 0x01 0x01 0x8d 0x02 0x00 0x00 0x01 0x01 0x01 0x8e 0x02 0x00 0x00 0x01 0x01 0x01 0x8f 0x01 0x00 0x00 0x01 0x01 0x01 0x90 0x01 0x00 0x00 0x01 0x01 0x01 0x91 0x01 0x00 0x00 0x01 0x01 0x01 0x92 0x01 0x00 0x00 0x01 0x01 0x01 0x93 0x01 0x00 0x00 0x01 0x01 0x01 0x94 0x01 0x00 0x00 0x01 0x01 0x01 0x95 0x01 0x00 0x00 0x01 0x01 0x01 0x96 0x01 0x00 0x00 0x01 0x01 0x01 0x97 0x01 0x00 0x00 0x01 0x01 0x01 0x98 0x01 0x00 0x00 0x01 0x01 0x01 0x99 0x01 0x00 0x00 0x01 0x01 0x01 0x9a 0x01 0x00 0x00 0x01 0x01 0x01 0x9b 0x01 0x00 0x00 0x01 0x01 0x01 0x9c 0x01 0x00 0x00 0x01 0x01 0x01 0x9d 0x03 0x00 0x00 0x01 0x01 0x01 0x9e 0x03 0x00 0x00 0x01 0x01 0x01 0x9f 0x00 0x01 0x00 0x01 0x00 0x01 0xa0 0x00 0x01 0x00 0x01 0x00 0x01 0xa1 0x00 0x00 0x00 0x01 0x00 0x01 0xa2 0x00 0x01 0x00 0x01 0x00 0x01 0xa3 0x00 0x01 0x00 0x01 0x00 0x01 0xa4 0x00 0x00 0x00 0x01 0x00 0x01 0xa5 0x00 0x00 0x00 0x01 0x00 0x01 0xa6 0x00 0x00 0x00 0x01 0x00 0x01 0xa7 0x00 0x00 0x00 0x01 0x00 0x01 0xa8 0x00 0x01 0x00 0x01 0x00 0x01 0xa9 0x01 0x00 0x00 0x00 0x00 0x01 0xaa 0x01 0x00 0x00 0x00 0x00 0x01 0xab 0x01 0x00 0x00 0x00 0x00 0x01 0xac 0x01 0x00 0x00 0x00 0x00 0x01 0xad 0x01 0x00 0x00 0x00 0x00 0x01 0xae 0x01 0x00 0x00 0x00 0x00 0x01 0xaf 0x01 0x00 0x00 0x00 0x00 0x01 0xb0 0x01 0x00 0x00 0x01 0x00 0x01 0xb1 0x01 0x00 0x00 0x00 0x00 0x01 0xb2 0x01 0x00 0x00 0x00 0x00 0x01 0xb3 0x01 0x00 0x00 0x00 0x00 0x01 0xb4 0x01 0x00 0x00 0x00 0x00 0x01 0xb5 0x01 0x00 0x00 0x00 0x00 0x01 0xb6 0x01 0x00 0x00 0x00 0x00 0x01 0xb7 0x00 0x00 0x00 0x01 0x01 0x01 0xb8 0x01 0x00 0x00 0x00 0x00 0x01 0xb9 0x01 0x00 0x00 0x01 0x00 0x01 0xba 0x01 0x00 0x00 0x01 0x00 0x01 0xbb 0x01 0x00 0x00 0x01 0x00 0x01 0xbc 0x00 0x01 0x00 0x01 0x00 0x01 0xbd 0x00 0x00 0x00 0x01 0x00 0x00 0xbe 0x00 0x00 0x00 0x01 0x00 0x01 0xbf 0x00 0x00 0x00 0x01 0x00 0x01 0xc0 0x00 0x00 0x00 0x01 0x00 0x01 0xc1 0x00 0x00 0x00 0x01 0x00 0x01 0xc2 0x00 0x00 0x00 0x01 0x00 0x01 0xc3 0x00 0x00 0x00 0x01 0x00 0x01 0xc4 0x00 0x00 0x00 0x01 0x00 0x01 0xc5 0x00 0x00 0x00 0x01 0x00 0x01 0xc6 0x00 0x00 0x00 0x01 0x00 0x01 0xc7 0x00 0x00 0x00 0x01 0x00 0x01 0xc8 0x00 0x00 0x00 0x01 0x00 0x01 0xc9 0x00 0x01 0x01 0x01 0x00 0x01 0xca 0x01 0x00 0x00 0x00 0x00 0x01 0xcb 0x01 0x00 0x00 0x00 0x00 0x01 0xcc 0x01 0x00 0x00 0x01 0x00 0x01 0xcd 0x01 0x00 0x00 0x01 0x00 0x01 0xce 0x01 0x00 0x00 0x01 0x00 0x01 0xcf 0x01 0x00 0x00 0x01 0x00 0x01 0xd0 0x01 0x00 0x00 0x00 0x00 0x01 0xd1 0x01 0x00 0x00 0x00 0x00 0x01 0xd2 0x01 0x00 0x00 0x00 0x00 0x01 0xd3 0x01 0x00 0x00 0x01 0x00 0x01 0xd4 0x01 0x00 0x00 0x01 0x00 0x01 0xd5 0x01 0x00 0x00 0x01 0x00 0x01 0xd6 0x01 0x00 0x00 0x00 0x00 0x01 0xd7 0x01 0x00 0x00 0x00 0x00 0x01 0xd8 0x01 0x00 0x00 0x01 0x00 0x01>;
		};
	};

	fragment@89 {
		target = <&subpmic_pmu_eint>;

		__overlay__ {
			interrupt-parent = <&pio>;
			interrupts = <0x03 0x08>;
			status = "okay";
		};
	};

	fragment@90 {
		target = <&swtp>;

		__overlay__ {
			interrupt-parent = <&pio>;
			interrupts = <0x0e 0x04>;
			status = "okay";
		};
	};

	fragment@91 {
		target = <&swtp_1>;

		__overlay__ {
			interrupt-parent = <&pio>;
			interrupts = <0x0f 0x04>;
			status = "okay";
		};
	};

	fragment@92 {
		target = <&swtp_2>;

		__overlay__ {
			interrupt-parent = <&pio>;
			interrupts = <0x11 0x04>;
			status = "okay";
		};
	};

	fragment@93 {
		target = <&irq_nfc>;

		__overlay__ {
			interrupt-parent = <&pio>;
			interrupts = <0x13 0x04>;
			status = "okay";
		};
	};

	fragment@94 {
		target = <&swtp_3>;

		__overlay__ {
			interrupt-parent = <&pio>;
			interrupts = <0x14 0x04>;
			status = "okay";
		};
	};

	fragment@95 {
		target = <&swtp_4>;

		__overlay__ {
			interrupt-parent = <&pio>;
			interrupts = <0x15 0x04>;
			status = "okay";
		};
	};

	fragment@96 {
		target = <&touch_panel>;

		__overlay__ {
			interrupt-parent = <&pio>;
			interrupts = <0x16 0x02>;
			status = "okay";
		};
	};

	fragment@97 {
		target = <&rt5133_eint>;

		__overlay__ {
			interrupt-parent = <&pio>;
			interrupts = <0x18 0x08>;
			status = "okay";
		};
	};

	fragment@98 {
		target = <&swtp_5>;

		__overlay__ {
			interrupt-parent = <&pio>;
			interrupts = <0x1e 0x04>;
			status = "okay";
		};
	};

	fragment@99 {
		target = <&hall_3>;

		__overlay__ {
			interrupt-parent = <&pio>;
			interrupts = <0x41 0x08>;
			status = "okay";
		};
	};

	fragment@100 {
		target = <&hall_4>;

		__overlay__ {
			interrupt-parent = <&pio>;
			interrupts = <0x42 0x08>;
			status = "okay";
		};
	};

	fragment@101 {
		target = <&dsi_te>;

		__overlay__ {
			interrupt-parent = <&pio>;
			interrupts = <0x60 0x01>;
			status = "okay";
		};
	};

	fragment@102 {
		target = <&swtp_6>;

		__overlay__ {
			interrupt-parent = <&pio>;
			interrupts = <0x7c 0x04>;
			status = "okay";
		};
	};

	fragment@103 {
		target = <&md1_sim1_hot_plug_eint>;

		__overlay__ {
			compatible = "mediatek,md1_sim1_hot_plug_eint-eint";
			interrupts = <0x00 0x08>;
			debounce = <0x00 0xc350>;
			dedicated = <0x00 0x00>;
			src_pin = <0x00 0x01>;
			sockettype = <0x00 0x00>;
			status = "okay";
		};
	};

	fragment@104 {
		target = <&md1_sim2_hot_plug_eint>;

		__overlay__ {
			compatible = "mediatek,md1_sim2_hot_plug_eint-eint";
			interrupts = <0x01 0x08>;
			debounce = <0x01 0xc350>;
			dedicated = <0x01 0x00>;
			src_pin = <0x01 0x02>;
			sockettype = <0x01 0x00>;
			status = "okay";
		};
	};

	fragment@105 {
		target = <&keypad>;

		__overlay__ {
			mediatek,key-debounce = <0x400>;
			mediatek,sw-pwrkey = <0x74>;
			mediatek,hw-pwrkey = <0x08>;
			mediatek,sw-rstkey = <0x72>;
			mediatek,hw-rstkey = <0x11>;
			mediatek,use-extend-type = <0x00>;
			mediatek,hw-map-num = <0x48>;
			mediatek,hw-init-map = <0x73 0x00 0x00 0x00 0x00 0x00 0x00 0x00 0x00 0x00 0x00 0x00 0x00 0x00 0x00 0x00 0x00 0x00 0x00 0x00 0x00 0x00 0x00 0x00 0x00 0x00 0x00 0x00 0x00 0x00 0x00 0x00 0x00 0x00 0x00 0x00 0x00 0x00 0x00 0x00 0x00 0x00 0x00 0x00 0x00 0x00 0x00 0x00 0x00 0x00 0x00 0x00 0x00 0x00 0x00 0x00 0x00 0x00 0x00 0x00 0x00 0x00 0x00 0x00 0x00 0x00 0x00 0x00 0x00 0x00 0x00 0x00>;
			mediatek,pwrkey-eint-gpio = <0x00>;
			mediatek,pwkey-gpio-din = <0x00>;
			mediatek,hw-dl-key0 = <0x00>;
			mediatek,hw-dl-key1 = <0x11>;
			mediatek,hw-dl-key2 = <0x08>;
			mediatek,hw-recovery-key = <0x00>;
			mediatek,hw-factory-key = <0x11>;
			status = "okay";
		};
	};

	fragment@106 {
		target = <&soc>;

		__overlay__ {

			cam_main_avdd_ldo: gpio120-fixed {
				compatible = "regulator-fixed";
				regulator-name = "cam_main_avdd_ldo";
				regulator-min-microvolt = <0x2ab980>;
				regulator-max-microvolt = <0x2ab980>;
				gpio = <&pio>, <0x78 0x00>;
				enable-active-high;
				phandle = <0x5f>;
			};

			cam_main_dvdd_ldo: gpio59-fixed {
				compatible = "regulator-fixed";
				regulator-name = "cam_main_dvdd_ldo";
				regulator-min-microvolt = <0x10c8e0>;
				regulator-max-microvolt = <0x10c8e0>;
				gpio = <&pio>, <0x3b 0x00>;
				enable-active-high;
				phandle = <0x60>;
			};
		};
	};

	fragment@107 {
		target = <&mtk_composite_v4l2_2>;

		__overlay__ {

			port@0 {

				main_af_endpoint: endpoint {
					remote-endpoint = <&main_af>;
					phandle = <0x51>;
				};
			};

			port@1 {

				wide_af_endpoint: endpoint {
					remote-endpoint = <&wide_af>;
					phandle = <0x53>;
				};
			};
		};
	};

	fragment@108 {
		target = <&i2c6>;

		__overlay__ {

			aw36518: aw36518@63 {
				compatible = "mediatek,aw36518";
				reg = <0x63>;
				#cooling-cells = <0x02>;
				status = "okay";
				phandle = <0x91>;

				flash@0 {
					reg = <0x00>;
					type = <0x00>;
					ct = <0x00>;
					part = <0x00>;

					port@0 {

						fl_core_0: endpoint {
							remote-endpoint = <&flashlight_0>;
							phandle = <0x54>;
						};
					};
				};
			};
		};
	};

	fragment@109 {
		target = <&i2c2>;

		__overlay__ {

			camera_af_main@18 {
				compatible = "mediatek,mot_manaus_gt9764";
				reg = <0x18>;
				vdd-supply = <&cam_main_afdd_ldo>;

				port {

					main_af: endpoint {
						remote-endpoint = <&main_af_endpoint>;
						phandle = <0x4d>;
					};
				};
			};
		};
	};

	fragment@110 {
		target = <&i2c8>;

		__overlay__ {

			camera_af_wide@18 {
				compatible = "mediatek,mot_manaus_dw9800v";
				reg = <0x18>;
				vin-supply = <&cam_uw_afvdd_ldo>;

				port {

					wide_af: endpoint {
						remote-endpoint = <&wide_af_endpoint>;
						phandle = <0x4e>;
					};
				};
			};
		};
	};

	fragment@111 {
		target = <&mtk_composite_v4l2_1>;

		__overlay__ {

			port@0 {

				flashlight_0: endpoint {
					remote-endpoint = <&fl_core_0>;
					phandle = <0x4f>;
				};
			};
		};
	};

	fragment@112 {
		target = <&seninf_top>;

		__overlay__ {

			seninf_csi_port_0: seninf_csi_port_0 {
				compatible = "mediatek,seninf";
				csi-port = "0";
				hs_trail_parameter = <0x73>;
				nvmem-cells = <&csi_efuse0>;
				nvmem-cell-names = "rg_csi";
				phandle = <0x92>;

				port {

					seninf_csi_port_0_in: endpoint {
						remote-endpoint = <&sensor1_out>;
						phandle = <0x6c>;
					};
				};
			};

			seninf_csi_port_1: seninf_csi_port_1 {
				compatible = "mediatek,seninf";
				csi-port = "1";
				hs_trail_parameter = <0x42>;
				nvmem-cells = <&csi_efuse1>;
				nvmem-cell-names = "rg_csi";
				phandle = <0x93>;

				port {

					seninf_csi_port_1_in: endpoint {
						remote-endpoint = <&sensor2_out>;
						phandle = <0x76>;
					};
				};
			};

			seninf_csi_port_2: seninf_csi_port_2 {
				compatible = "mediatek,seninf";
				csi-port = "2";
				cphy_settle_delay_dt = <0x1f>;
				nvmem-cells = <&csi_efuse2>;
				nvmem-cell-names = "rg_csi";
				phandle = <0x94>;

				port {

					seninf_csi_port_2_in: endpoint {
						remote-endpoint = <&sensor0_out>;
						phandle = <0x62>;
					};
				};
			};
		};
	};

	fragment@113 {
		target = <&pio>;

		__overlay__ {

			camera_pins_cam0_mclk_off: camera_pins_cam0_mclk_off {
				phandle = <0x58>;

				pins_cmd_dat {
					pinmux = <0x6400>;
					drive-strength = <0x01>;
				};
			};

			camera_pins_cam0_mclk_2ma: camera_pins_cam0_mclk_2ma {
				phandle = <0x59>;

				pins_cmd_dat {
					pinmux = <0x6401>;
					drive-strength = <0x00>;
				};
			};

			camera_pins_cam0_mclk_4ma: camera_pins_cam0_mclk_4ma {
				phandle = <0x5a>;

				pins_cmd_dat {
					pinmux = <0x6401>;
					drive-strength = <0x01>;
				};
			};

			camera_pins_cam0_mclk_6ma: camera_pins_cam0_mclk_6ma {
				phandle = <0x5b>;

				pins_cmd_dat {
					pinmux = <0x6401>;
					drive-strength = <0x02>;
				};
			};

			camera_pins_cam0_mclk_8ma: camera_pins_cam0_mclk_8ma {
				phandle = <0x5c>;

				pins_cmd_dat {
					pinmux = <0x6401>;
					drive-strength = <0x03>;
				};
			};

			camera_pins_cam0_rst_0: cam0@0 {
				phandle = <0x5d>;

				pins_cmd_dat {
					pinmux = <0x2100>;
					slew-rate = <0x01>;
					output-low;
				};
			};

			camera_pins_cam0_rst_1: cam0@1 {
				phandle = <0x5e>;

				pins_cmd_dat {
					pinmux = <0x2100>;
					slew-rate = <0x01>;
					output-high;
				};
			};

			camera_pins_cam1_mclk_off: camera_pins_cam1_mclk_off {
				phandle = <0x63>;

				pins_cmd_dat {
					pinmux = <0x6300>;
					drive-strength = <0x01>;
				};
			};

			camera_pins_cam1_mclk_2ma: camera_pins_cam1_mclk_2ma {
				phandle = <0x64>;

				pins_cmd_dat {
					pinmux = <0x6301>;
					drive-strength = <0x00>;
				};
			};

			camera_pins_cam1_mclk_4ma: camera_pins_cam1_mclk_4ma {
				phandle = <0x65>;

				pins_cmd_dat {
					pinmux = <0x6301>;
					drive-strength = <0x01>;
				};
			};

			camera_pins_cam1_mclk_6ma: camera_pins_cam1_mclk_6ma {
				phandle = <0x66>;

				pins_cmd_dat {
					pinmux = <0x6301>;
					drive-strength = <0x02>;
				};
			};

			camera_pins_cam1_mclk_8ma: camera_pins_cam1_mclk_8ma {
				phandle = <0x67>;

				pins_cmd_dat {
					pinmux = <0x6301>;
					drive-strength = <0x03>;
				};
			};

			camera_pins_cam1_rst_0: cam1@0 {
				phandle = <0x68>;

				pins_cmd_dat {
					pinmux = <0x2000>;
					slew-rate = <0x01>;
					output-low;
				};
			};

			camera_pins_cam1_rst_1: cam1@1 {
				phandle = <0x69>;

				pins_cmd_dat {
					pinmux = <0x2000>;
					slew-rate = <0x01>;
					output-high;
				};
			};

			camera_pins_cam2_mclk_off: camera_pins_cam2_mclk_off {
				phandle = <0x6d>;

				pins_cmd_dat {
					pinmux = <0x6600>;
					drive-strength = <0x01>;
				};
			};

			camera_pins_cam2_mclk_2ma: camera_pins_cam2_mclk_2ma {
				phandle = <0x6e>;

				pins_cmd_dat {
					pinmux = <0x6601>;
					drive-strength = <0x00>;
				};
			};

			camera_pins_cam2_mclk_4ma: camera_pins_cam2_mclk_4ma {
				phandle = <0x6f>;

				pins_cmd_dat {
					pinmux = <0x6601>;
					drive-strength = <0x01>;
				};
			};

			camera_pins_cam2_mclk_6ma: camera_pins_cam2_mclk_6ma {
				phandle = <0x70>;

				pins_cmd_dat {
					pinmux = <0x6601>;
					drive-strength = <0x02>;
				};
			};

			camera_pins_cam2_mclk_8ma: camera_pins_cam2_mclk_8ma {
				phandle = <0x71>;

				pins_cmd_dat {
					pinmux = <0x6601>;
					drive-strength = <0x03>;
				};
			};

			camera_pins_cam2_rst_0: cam2@0 {
				phandle = <0x72>;

				pins_cmd_dat {
					pinmux = <0x6200>;
					slew-rate = <0x01>;
					output-low;
				};
			};

			camera_pins_cam2_rst_1: cam2@1 {
				phandle = <0x73>;

				pins_cmd_dat {
					pinmux = <0x6200>;
					slew-rate = <0x01>;
					output-high;
				};
			};

			camera_pins_default: camdefault {
				phandle = <0x95>;
			};
		};
	};

	fragment@114 {
		target = <&i2c2>;

		__overlay__ {
			status = "okay";
			clock-frequency = <0xf4240>;
			#address-cells = <0x01>;
			#size-cells = <0x00>;

			mtk_camera_eeprom0: camera_eeprom0@50 {
				compatible = "mediatek,camera_eeprom";
				reg = <0x50>;
				status = "okay";
				phandle = <0x96>;
			};

			sensor0: sensor0@20 {
				compatible = "mediatek,imgsensor";
				sensor-names = "mot_manaus_ov50a_mipi_raw";
				reg = <0x20>;
				#thermal-sensor-cells = <0x00>;
				pinctrl-names = "mclk_off", "mclk_2mA", "mclk_4mA", "mclk_6mA", "mclk_8mA", "rst_low", "rst_high";
				pinctrl-0 = <&camera_pins_cam0_mclk_off>;
				pinctrl-1 = <&camera_pins_cam0_mclk_2ma>;
				pinctrl-2 = <&camera_pins_cam0_mclk_4ma>;
				pinctrl-3 = <&camera_pins_cam0_mclk_6ma>;
				pinctrl-4 = <&camera_pins_cam0_mclk_8ma>;
				pinctrl-5 = <&camera_pins_cam0_rst_0>;
				pinctrl-6 = <&camera_pins_cam0_rst_1>;
				avdd-supply = <&cam_main_avdd_ldo>;
				dvdd-supply = <&cam_main_dvdd_ldo>;
				dovdd-supply = <&cam_iovdd_ldo>;
				clocks = <&topckgen_clk>, <0x7f>, <&topckgen_clk>, <0x7e>, <&topckgen_clk>, <0x9c>, <&topckgen_clk>, <0x7d>, <&topckgen_clk>, <0x7c>, <&topckgen_clk>, <0x76>, <&topckgen_clk>, <0x7b>, <&topckgen_clk>, <0x75>, <&topckgen_clk>, <0x12>;
				clock-names = "6", "12", "13", "19.2", "24", "26", "48", "52", "mclk";
				status = "okay";
				phandle = <0x77>;

				port {

					sensor0_out: endpoint {
						remote-endpoint = <&seninf_csi_port_2_in>;
						phandle = <0x57>;
					};
				};
			};
		};
	};

	fragment@115 {
		target = <&i2c4>;

		__overlay__ {
			status = "okay";
			clock-frequency = <0xf4240>;
			#address-cells = <0x01>;
			#size-cells = <0x00>;

			mtk_camera_eeprom1: camera_eeprom1@50 {
				compatible = "mediatek,camera_eeprom";
				reg = <0x50>;
				status = "okay";
				phandle = <0x97>;
			};

			sensor1: sensor1@20 {
				compatible = "mediatek,imgsensor";
				sensor-names = "mot_manaus_ov32b_mipi_raw";
				reg = <0x20>;
				#thermal-sensor-cells = <0x00>;
				pinctrl-names = "mclk_off", "mclk_2mA", "mclk_4mA", "mclk_6mA", "mclk_8mA", "rst_low", "rst_high";
				pinctrl-0 = <&camera_pins_cam1_mclk_off>;
				pinctrl-1 = <&camera_pins_cam1_mclk_2ma>;
				pinctrl-2 = <&camera_pins_cam1_mclk_4ma>;
				pinctrl-3 = <&camera_pins_cam1_mclk_6ma>;
				pinctrl-4 = <&camera_pins_cam1_mclk_8ma>;
				pinctrl-5 = <&camera_pins_cam1_rst_0>;
				pinctrl-6 = <&camera_pins_cam1_rst_1>;
				avdd-supply = <&cam_fm_avdd_ldo>;
				dvdd-supply = <&cam_fm_dvdd_ldo>;
				dovdd-supply = <&cam_iovdd_ldo>;
				clocks = <&topckgen_clk>, <0x7f>, <&topckgen_clk>, <0x7e>, <&topckgen_clk>, <0x9c>, <&topckgen_clk>, <0x7d>, <&topckgen_clk>, <0x7c>, <&topckgen_clk>, <0x76>, <&topckgen_clk>, <0x7b>, <&topckgen_clk>, <0x75>, <&topckgen_clk>, <0x11>;
				clock-names = "6", "12", "13", "19.2", "24", "26", "48", "52", "mclk";
				status = "okay";
				phandle = <0x78>;

				port {

					sensor1_out: endpoint {
						remote-endpoint = <&seninf_csi_port_0_in>;
						phandle = <0x55>;
					};
				};
			};
		};
	};

	fragment@116 {
		target = <&i2c8>;

		__overlay__ {
			status = "okay";
			clock-frequency = <0xf4240>;
			#address-cells = <0x01>;
			#size-cells = <0x00>;

			mtk_camera_eeprom2: camera_eeprom2@50 {
				compatible = "mediatek,camera_eeprom";
				reg = <0x50>;
				status = "okay";
				phandle = <0x98>;
			};

			sensor2: sensor2@40 {
				compatible = "mediatek,imgsensor";
				sensor-names = "mot_manaus_hi1336_mipi_raw";
				reg = <0x40>;
				#thermal-sensor-cells = <0x00>;
				pinctrl-names = "mclk_off", "mclk_2mA", "mclk_4mA", "mclk_6mA", "mclk_8mA", "rst_low", "rst_high";
				pinctrl-0 = <&camera_pins_cam2_mclk_off>;
				pinctrl-1 = <&camera_pins_cam2_mclk_2ma>;
				pinctrl-2 = <&camera_pins_cam2_mclk_4ma>;
				pinctrl-3 = <&camera_pins_cam2_mclk_6ma>;
				pinctrl-4 = <&camera_pins_cam2_mclk_8ma>;
				pinctrl-5 = <&camera_pins_cam2_rst_0>;
				pinctrl-6 = <&camera_pins_cam2_rst_1>;
				avdd-supply = <&cam_uw_avdd_ldo>;
				dvdd-supply = <&cam_uw_dvdd_ldo>;
				dovdd-supply = <&cam_iovdd_ldo>;
				clocks = <&topckgen_clk>, <0x7f>, <&topckgen_clk>, <0x7e>, <&topckgen_clk>, <0x9c>, <&topckgen_clk>, <0x7d>, <&topckgen_clk>, <0x7c>, <&topckgen_clk>, <0x76>, <&topckgen_clk>, <0x7b>, <&topckgen_clk>, <0x75>, <&topckgen_clk>, <0x14>;
				clock-names = "6", "12", "13", "19.2", "24", "26", "48", "52", "mclk";
				status = "okay";
				phandle = <0x79>;

				port {

					sensor2_out: endpoint {
						remote-endpoint = <&seninf_csi_port_1_in>;
						phandle = <0x56>;
					};
				};
			};
		};
	};

	fragment@117 {
		target = <&thermal_zones>;

		__overlay__ {

			camera0: camera0 {
				polling-delay = <0x00>;
				polling-delay-passive = <0x00>;
				thermal-sensors = <&sensor0>;
				phandle = <0x99>;
			};

			camera1: camera1 {
				polling-delay = <0x00>;
				polling-delay-passive = <0x00>;
				thermal-sensors = <&sensor1>;
				phandle = <0x9a>;
			};

			camera2: camera2 {
				polling-delay = <0x00>;
				polling-delay-passive = <0x00>;
				thermal-sensors = <&sensor2>;
				phandle = <0x9b>;
			};
		};
	};

	__symbols__ {
		vibrator0 = "/fragment@4/__overlay__/vibrator@0";
		gps_pins_default = "/fragment@5/__overlay__/gps_default";
		gps_l1_lna_pins_ol = "/fragment@5/__overlay__/gps_l1_lna@0";
		gps_l1_lna_pins_dsp_ctrl = "/fragment@5/__overlay__/gps_l1_lna@1";
		gps_l1_lna_pins_oh = "/fragment@5/__overlay__/gps_l1_lna@2";
		gps_l5_lna_pins_ol = "/fragment@5/__overlay__/gps_l5_lna@0";
		gps_l5_lna_pins_dsp_ctrl = "/fragment@5/__overlay__/gps_l5_lna@1";
		gps_l5_lna_pins_oh = "/fragment@5/__overlay__/gps_l5_lna@2";
		sel_up = "/fragment@7/__overlay__/sel_high";
		sel_down = "/fragment@7/__overlay__/sel_low";
		sw_enable = "/fragment@7/__overlay__/sw_enable";
		sw_disable = "/fragment@7/__overlay__/sw_disable";
		ps_enable = "/fragment@7/__overlay__/ps_enable";
		ps_disable = "/fragment@7/__overlay__/ps_disable";
		tcpc_typec_usb = "/fragment@10/__overlay__/port/endpoint@0";
		ssusb_mux = "/fragment@11/__overlay__/port/endpoint@0";
		mtkfb_pins_lcm_led_en1 = "/fragment@12/__overlay__/lcm_led_en1_gpio";
		mtkfb_pins_lcm_led_en0 = "/fragment@12/__overlay__/lcm_led_en0_gpio";
		mtkfb_pins_lcm_rst_out1_gpio = "/fragment@12/__overlay__/lcm_rst_out1_gpio";
		mtkfb_pins_lcm_rst_out0_gpio = "/fragment@12/__overlay__/lcm_rst_out0_gpio";
		mtkfb_pins_lcm_dsi_te = "/fragment@12/__overlay__/lcm_dsi_te";
		panel1 = "/fragment@15/__overlay__/panel1@0";
		dsi_out = "/fragment@15/__overlay__/ports/port/endpoint";
		spk = "/fragment@17/__overlay__/speaker_amp@5c";
		aud_clk_mosi_off = "/fragment@20/__overlay__/aud_clk_mosi_off";
		aud_clk_mosi_on = "/fragment@20/__overlay__/aud_clk_mosi_on";
		aud_dat_mosi_off = "/fragment@20/__overlay__/aud_dat_mosi_off";
		aud_dat_mosi_on = "/fragment@20/__overlay__/aud_dat_mosi_on";
		aud_dat_mosi_ch34_off = "/fragment@20/__overlay__/aud_dat_mosi_ch34_off";
		aud_dat_mosi_ch34_on = "/fragment@20/__overlay__/aud_dat_mosi_ch34_on";
		aud_dat_miso0_off = "/fragment@20/__overlay__/aud_dat_miso0_off";
		aud_dat_miso0_on = "/fragment@20/__overlay__/aud_dat_miso0_on";
		aud_dat_miso1_off = "/fragment@20/__overlay__/aud_dat_miso1_off";
		aud_dat_miso1_on = "/fragment@20/__overlay__/aud_dat_miso1_on";
		aud_dat_miso2_off = "/fragment@20/__overlay__/aud_dat_miso2_off";
		aud_dat_miso2_on = "/fragment@20/__overlay__/aud_dat_miso2_on";
		vow_dat_miso_off = "/fragment@20/__overlay__/vow_dat_miso_off";
		vow_dat_miso_on = "/fragment@20/__overlay__/vow_dat_miso_on";
		vow_clk_miso_off = "/fragment@20/__overlay__/vow_clk_miso_off";
		vow_clk_miso_on = "/fragment@20/__overlay__/vow_clk_miso_on";
		aud_nle_mosi_off = "/fragment@20/__overlay__/aud_nle_mosi_off";
		aud_nle_mosi_on = "/fragment@20/__overlay__/aud_nle_mosi_on";
		aud_gpio_i2s2_off = "/fragment@20/__overlay__/aud_gpio_i2s2_off";
		aud_gpio_i2s2_on = "/fragment@20/__overlay__/aud_gpio_i2s2_on";
		aud_gpio_i2s1_off = "/fragment@20/__overlay__/aud_gpio_i2s1_off";
		aud_gpio_i2s1_on = "/fragment@20/__overlay__/aud_gpio_i2s1_on";
		sar_int_default = "/fragment@20/__overlay__/sar_int_default";
		sar_int_sleep = "/fragment@20/__overlay__/sar_int_sleep";
		sx937x = "/fragment@22/__overlay__/sx937x@2c";
		awinic_sar = "/fragment@22/__overlay__/awinic_sar@12";
		conninfra_pins_default = "/fragment@24/__overlay__/conninfra_pins_default";
		conninfra_pins_tcxo_set = "/fragment@24/__overlay__/conninfra_tcxo_set@gpio";
		conninfra_pins_tcxo_clr = "/fragment@24/__overlay__/conninfra_tcxo_clr@gpio";
		ctp_gt9896s_pins_default = "/fragment@27/__overlay__/pins_default";
		ctp_gt9896s_int_active = "/fragment@27/__overlay__/int1_active";
		ctp_gt9896s_reset_active = "/fragment@27/__overlay__/reset1_active";
		ctp_gt9896s_stylus_active = "/fragment@27/__overlay__/stylus1_active";
		ctp_gt9896s_int_suspend = "/fragment@27/__overlay__/int1_suspend";
		ctp_gt9896s_reset_suspend = "/fragment@27/__overlay__/reset1_suspend";
		ctp_gt9896s_stylus_suspend = "/fragment@27/__overlay__/stylus1_suspend";
		ctp_gt9896s_spi_mode = "/fragment@27/__overlay__/spimode_default";
		ctp_gpio_release = "/fragment@27/__overlay__/gpio_release";
		mtkfb_pins_oled_vci_en = "/fragment@31/__overlay__/oled_vci_en_gpio";
		mtkfb_pins_oled_vio_en = "/fragment@31/__overlay__/oled_vio_en_gpio";
		mtkfb_pins_oled_avdd_en0 = "/fragment@31/__overlay__/oled_dvdd_en0_gpio";
		mtkfb_pins_oled_avdd_en1 = "/fragment@31/__overlay__/oled_dvdd_en1_gpio";
		panel_in1 = "/fragment@32/__overlay__/panel1@0/port/endpoint";
		panel_in2 = "/fragment@32/__overlay__/panel2@0/port/endpoint";
		panel_in3 = "/fragment@32/__overlay__/panel3@0/port/endpoint";
		panel_in4 = "/fragment@32/__overlay__/panel4@0/port/endpoint";
		pen_int_default = "/fragment@34/__overlay__/pen_int_default";
		pen_int_sleep = "/fragment@34/__overlay__/pen_int_sleep";
		folio_int_default = "/fragment@34/__overlay__/folio_int_default";
		folio_int_sleep = "/fragment@34/__overlay__/folio_int_sleep";
		wl2864c = "/fragment@37/__overlay__/wl2864c@29";
		cam_fm_dvdd_ldo = "/fragment@37/__overlay__/wl2864c@29/regulators/ldo1";
		cam_uw_dvdd_ldo = "/fragment@37/__overlay__/wl2864c@29/regulators/ldo2";
		cam_uw_avdd_ldo = "/fragment@37/__overlay__/wl2864c@29/regulators/ldo3";
		cam_main_afdd_ldo = "/fragment@37/__overlay__/wl2864c@29/regulators/ldo4";
		cam_fm_avdd_ldo = "/fragment@37/__overlay__/wl2864c@29/regulators/ldo5";
		cam_uw_afvdd_ldo = "/fragment@37/__overlay__/wl2864c@29/regulators/ldo6";
		cam_iovdd_ldo = "/fragment@37/__overlay__/wl2864c@29/regulators/ldo7";
		aw882xx_smartpa_1 = "/fragment@41/__overlay__/aw882xx@35";
		aw882xx_smartpa_0 = "/fragment@41/__overlay__/aw882xx@34";
		fsa4480_switch = "/fragment@41/__overlay__/fsa4480@42";
		nfc_pn5xx = "/fragment@45/__overlay__/nfc_pn5xx@28";
		p61 = "/fragment@46/__overlay__/p61@0";
		pinctrl_state_mode_spi = "/fragment@47/__overlay__/pinctrl_state_mode_spi";
		pinctrl_state_mode_idle = "/fragment@47/__overlay__/pinctrl_state_mode_idle";
		goodix_fp = "/fragment@49/__overlay__/goodix_fp";
		chg_ntc = "/fragment@53/__overlay__/chg_ntc";
		quiet_ntc = "/fragment@53/__overlay__/quiet_ntc";
		tspk_ntc = "/fragment@53/__overlay__/tspk_ntc";
		vibrator_irq_input = "/fragment@55/__overlay__/vibrator_irq_input";
		fingerfp_rst_high = "/fragment@55/__overlay__/fingerfp_rst_high";
		fingerfp_rst_low = "/fragment@55/__overlay__/fingerfp_rst_low";
		fingerfp_irq_active = "/fragment@55/__overlay__/fingerfp_irq_active";
		fingerfp_spi_active = "/fragment@55/__overlay__/fingerfp_spi_active";
		fingerfp_spi_default = "/fragment@55/__overlay__/fingerfp_spi_default";
		mtee = "/fragment@65/__overlay__/MTEE";
		svp = "/fragment@65/__overlay__/SecureVideoPath";
		bq25960_int_default_master = "/fragment@75/__overlay__/bq25960_int_default_master";
		bq25960_int_default_slave = "/fragment@75/__overlay__/bq25960_int_default_slave";
		NFG1000 = "/fragment@76/__overlay__/NFG1000@55";
		bq25960_master = "/fragment@76/__overlay__/bq25960-master@66";
		bq25960_slave = "/fragment@76/__overlay__/bq25960-slave@67";
		cam_main_avdd_ldo = "/fragment@106/__overlay__/gpio120-fixed";
		cam_main_dvdd_ldo = "/fragment@106/__overlay__/gpio59-fixed";
		main_af_endpoint = "/fragment@107/__overlay__/port@0/endpoint";
		wide_af_endpoint = "/fragment@107/__overlay__/port@1/endpoint";
		aw36518 = "/fragment@108/__overlay__/aw36518@63";
		fl_core_0 = "/fragment@108/__overlay__/aw36518@63/flash@0/port@0/endpoint";
		main_af = "/fragment@109/__overlay__/camera_af_main@18/port/endpoint";
		wide_af = "/fragment@110/__overlay__/camera_af_wide@18/port/endpoint";
		flashlight_0 = "/fragment@111/__overlay__/port@0/endpoint";
		seninf_csi_port_0 = "/fragment@112/__overlay__/seninf_csi_port_0";
		seninf_csi_port_0_in = "/fragment@112/__overlay__/seninf_csi_port_0/port/endpoint";
		seninf_csi_port_1 = "/fragment@112/__overlay__/seninf_csi_port_1";
		seninf_csi_port_1_in = "/fragment@112/__overlay__/seninf_csi_port_1/port/endpoint";
		seninf_csi_port_2 = "/fragment@112/__overlay__/seninf_csi_port_2";
		seninf_csi_port_2_in = "/fragment@112/__overlay__/seninf_csi_port_2/port/endpoint";
		camera_pins_cam0_mclk_off = "/fragment@113/__overlay__/camera_pins_cam0_mclk_off";
		camera_pins_cam0_mclk_2ma = "/fragment@113/__overlay__/camera_pins_cam0_mclk_2ma";
		camera_pins_cam0_mclk_4ma = "/fragment@113/__overlay__/camera_pins_cam0_mclk_4ma";
		camera_pins_cam0_mclk_6ma = "/fragment@113/__overlay__/camera_pins_cam0_mclk_6ma";
		camera_pins_cam0_mclk_8ma = "/fragment@113/__overlay__/camera_pins_cam0_mclk_8ma";
		camera_pins_cam0_rst_0 = "/fragment@113/__overlay__/cam0@0";
		camera_pins_cam0_rst_1 = "/fragment@113/__overlay__/cam0@1";
		camera_pins_cam1_mclk_off = "/fragment@113/__overlay__/camera_pins_cam1_mclk_off";
		camera_pins_cam1_mclk_2ma = "/fragment@113/__overlay__/camera_pins_cam1_mclk_2ma";
		camera_pins_cam1_mclk_4ma = "/fragment@113/__overlay__/camera_pins_cam1_mclk_4ma";
		camera_pins_cam1_mclk_6ma = "/fragment@113/__overlay__/camera_pins_cam1_mclk_6ma";
		camera_pins_cam1_mclk_8ma = "/fragment@113/__overlay__/camera_pins_cam1_mclk_8ma";
		camera_pins_cam1_rst_0 = "/fragment@113/__overlay__/cam1@0";
		camera_pins_cam1_rst_1 = "/fragment@113/__overlay__/cam1@1";
		camera_pins_cam2_mclk_off = "/fragment@113/__overlay__/camera_pins_cam2_mclk_off";
		camera_pins_cam2_mclk_2ma = "/fragment@113/__overlay__/camera_pins_cam2_mclk_2ma";
		camera_pins_cam2_mclk_4ma = "/fragment@113/__overlay__/camera_pins_cam2_mclk_4ma";
		camera_pins_cam2_mclk_6ma = "/fragment@113/__overlay__/camera_pins_cam2_mclk_6ma";
		camera_pins_cam2_mclk_8ma = "/fragment@113/__overlay__/camera_pins_cam2_mclk_8ma";
		camera_pins_cam2_rst_0 = "/fragment@113/__overlay__/cam2@0";
		camera_pins_cam2_rst_1 = "/fragment@113/__overlay__/cam2@1";
		camera_pins_default = "/fragment@113/__overlay__/camdefault";
		mtk_camera_eeprom0 = "/fragment@114/__overlay__/camera_eeprom0@50";
		sensor0 = "/fragment@114/__overlay__/sensor0@20";
		sensor0_out = "/fragment@114/__overlay__/sensor0@20/port/endpoint";
		mtk_camera_eeprom1 = "/fragment@115/__overlay__/camera_eeprom1@50";
		sensor1 = "/fragment@115/__overlay__/sensor1@20";
		sensor1_out = "/fragment@115/__overlay__/sensor1@20/port/endpoint";
		mtk_camera_eeprom2 = "/fragment@116/__overlay__/camera_eeprom2@50";
		sensor2 = "/fragment@116/__overlay__/sensor2@40";
		sensor2_out = "/fragment@116/__overlay__/sensor2@40/port/endpoint";
		camera0 = "/fragment@117/__overlay__/camera0";
		camera1 = "/fragment@117/__overlay__/camera1";
		camera2 = "/fragment@117/__overlay__/camera2";
	};

	__fixups__ {
		utags = "/fragment@0:target:0";
		hw = "/fragment@1:target:0";
		chosen = "/fragment@2:target:0", "/fragment@71/__overlay__:bootmode:0";
		mtk_leds = "/fragment@3:target:0", "/fragment@29:target:0";
		odm = "/fragment@4:target:0", "/fragment@35:target:0", "/fragment@36:target:0";
		pio = "/fragment@5:target:0", "/fragment@7:target:0", "/fragment@12:target:0", "/fragment@15/__overlay__/panel1@0:pm-enable-gpios:0", "/fragment@15/__overlay__/panel1@0:reset-gpios:0", "/fragment@16/__overlay__/epa_elna_mtk/hwid:gpio:0", "/fragment@20:target:0", "/fragment@22/__overlay__/sx937x@2c:interrupt-parent:0", "/fragment@22/__overlay__/sx937x@2c:Semtech,nirq-gpio:0", "/fragment@22/__overlay__/awinic_sar@12:interrupt-parent:0", "/fragment@22/__overlay__/awinic_sar@12:irq-gpio:0", "/fragment@24:target:0", "/fragment@26/__overlay__/goodix_ts_spi@0:goodix,reset-gpio:0", "/fragment@26/__overlay__/goodix_ts_spi@0:goodix,irq-gpio:0", "/fragment@26/__overlay__/goodix_ts_spi@0:goodix,avdd-gpio:0", "/fragment@26/__overlay__/focaltech@1:focaltech,reset-gpio:0", "/fragment@26/__overlay__/focaltech@1:focaltech,irq-gpio:0", "/fragment@26/__overlay__/focaltech@1:focaltech,vdd-gpio:0", "/fragment@27:target:0", "/fragment@31:target:0", "/fragment@32/__overlay__/panel1@0:pm-enable-gpios:0", "/fragment@32/__overlay__/panel1@0:pm-enable-gpios:12", "/fragment@32/__overlay__/panel1@0:pm-enable-gpios:24", "/fragment@32/__overlay__/panel1@0:pm-enable-gpios:36", "/fragment@32/__overlay__/panel1@0:reset-gpios:0", "/fragment@32/__overlay__/panel2@0:pm-enable-gpios:0", "/fragment@32/__overlay__/panel2@0:pm-enable-gpios:12", "/fragment@32/__overlay__/panel2@0:pm-enable-gpios:24", "/fragment@32/__overlay__/panel2@0:pm-enable-gpios:36", "/fragment@32/__overlay__/panel2@0:reset-gpios:0", "/fragment@32/__overlay__/panel3@0:pm-enable-gpios:0", "/fragment@32/__overlay__/panel3@0:pm-enable-gpios:12", "/fragment@32/__overlay__/panel3@0:pm-enable-gpios:24", "/fragment@32/__overlay__/panel3@0:pm-enable-gpios:36", "/fragment@32/__overlay__/panel3@0:reset-gpios:0", "/fragment@32/__overlay__/panel4@0:pm-enable-gpios:0", "/fragment@32/__overlay__/panel4@0:pm-enable-gpios:12", "/fragment@32/__overlay__/panel4@0:pm-enable-gpios:24", "/fragment@32/__overlay__/panel4@0:reset-gpios:0", "/fragment@34:target:0", "/fragment@35/__overlay__/hall_pen_detect:hall,nirq-gpio_0:0", "/fragment@35/__overlay__/hall_pen_detect:hall,nirq-gpio_1:0", "/fragment@36/__overlay__/hall_folio_detect:hall,nirq-gpio_0:0", "/fragment@36/__overlay__/hall_folio_detect:hall,nirq-gpio_1:0", "/fragment@37/__overlay__/wl2864c@29:semi,cs-gpios:0", "/fragment@41/__overlay__/aw882xx@35:irq-gpio:0", "/fragment@41/__overlay__/aw882xx@35:rcv-gpio:0", "/fragment@41/__overlay__/aw882xx@34:irq-gpio:0", "/fragment@45/__overlay__/nfc_pn5xx@28:interrupt-parent:0", "/fragment@45/__overlay__/nfc_pn5xx@28:qcom,sn-irq:0", "/fragment@45/__overlay__/nfc_pn5xx@28:qcom,sn-ven:0", "/fragment@47:target:0", "/fragment@49/__overlay__/fp_egistec:interrupt-parent:0", "/fragment@49/__overlay__/fp_egistec:egistec,gpio_reset:0", "/fragment@49/__overlay__/fp_egistec:egistec,gpio_irq:0", "/fragment@49/__overlay__/goodix_fp:interrupt-parent:0", "/fragment@49/__overlay__/goodix_fp:int-gpios:0", "/fragment@55:target:0", "/fragment@58/__overlay__:interrupt-parent:0", "/fragment@58/__overlay__:deb-gpios:0", "/fragment@59/__overlay__:interrupt-parent:0", "/fragment@59/__overlay__:deb-gpios:0", "/fragment@60/__overlay__:interrupt-parent:0", "/fragment@60/__overlay__:deb-gpios:0", "/fragment@61/__overlay__:interrupt-parent:0", "/fragment@61/__overlay__:deb-gpios:0", "/fragment@62/__overlay__:interrupt-parent:0", "/fragment@62/__overlay__:deb-gpios:0", "/fragment@63/__overlay__:interrupt-parent:0", "/fragment@63/__overlay__:deb-gpios:0", "/fragment@64/__overlay__:interrupt-parent:0", "/fragment@64/__overlay__:deb-gpios:0", "/fragment@75:target:0", "/fragment@76/__overlay__/bq25960-master@66:interrupt-parent:0", "/fragment@76/__overlay__/bq25960-slave@67:interrupt-parent:0", "/fragment@84/__overlay__/charging:gpios:0", "/fragment@87/__overlay__:GPIO_SIM1_HOT_PLUG:0", "/fragment@87/__overlay__:GPIO_SIM2_HOT_PLUG:0", "/fragment@87/__overlay__:GPIO_SIM1_SCLK:0", "/fragment@87/__overlay__:GPIO_SIM1_SRST:0", "/fragment@87/__overlay__:GPIO_SIM1_SIO:0", "/fragment@87/__overlay__:GPIO_SIM2_SCLK:0", "/fragment@87/__overlay__:GPIO_SIM2_SRST:0", "/fragment@87/__overlay__:GPIO_SIM2_SIO:0", "/fragment@87/__overlay__:GPIO_FDD_BAND_SUPPORT_DETECT_2ND_PIN:0", "/fragment@87/__overlay__:GPIO_FDD_BAND_SUPPORT_DETECT_1ST_PIN:0", "/fragment@89/__overlay__:interrupt-parent:0", "/fragment@90/__overlay__:interrupt-parent:0", "/fragment@91/__overlay__:interrupt-parent:0", "/fragment@92/__overlay__:interrupt-parent:0", "/fragment@93/__overlay__:interrupt-parent:0", "/fragment@94/__overlay__:interrupt-parent:0", "/fragment@95/__overlay__:interrupt-parent:0", "/fragment@96/__overlay__:interrupt-parent:0", "/fragment@97/__overlay__:interrupt-parent:0", "/fragment@98/__overlay__:interrupt-parent:0", "/fragment@99/__overlay__:interrupt-parent:0", "/fragment@100/__overlay__:interrupt-parent:0", "/fragment@101/__overlay__:interrupt-parent:0", "/fragment@102/__overlay__:interrupt-parent:0", "/fragment@106/__overlay__/gpio120-fixed:gpio:0", "/fragment@106/__overlay__/gpio59-fixed:gpio:0", "/fragment@113:target:0";
		gps = "/fragment@6:target:0";
		ps5169 = "/fragment@8:target:0", "/fragment@39:target:0";
		fusb304 = "/fragment@9:target:0", "/fragment@25:target:0";
		mt6375_typec = "/fragment@10:target:0", "/fragment@68:target:0", "/fragment@83:target:0";
		typec_mux_switch = "/fragment@11:target:0";
		mtkfb = "/fragment@13:target:0", "/fragment@30:target:0";
		dispsys_config = "/fragment@14:target:0", "/fragment@28:target:0";
		dsi0 = "/fragment@15:target:0", "/fragment@32:target:0";
		connfem = "/fragment@16:target:0";
		nofem = "/fragment@16/__overlay__/epa_elna_mtk:parts:0", "/fragment@16/__overlay__/epa_elna_mtk:parts:4", "/fragment@16/__overlay__/epa_elna_mtk:parts:16";
		qm42195 = "/fragment@16/__overlay__/epa_elna_mtk:parts:8", "/fragment@16/__overlay__/epa_elna_mtk:parts:24", "/fragment@16/__overlay__/epa_elna_mtk:parts:32", "/fragment@16/__overlay__/epa_elna_mtk:parts:40", "/fragment@16/__overlay__/epa_elna_mtk:parts:48";
		qm45197 = "/fragment@16/__overlay__/epa_elna_mtk:parts:12", "/fragment@16/__overlay__/epa_elna_mtk:parts:36", "/fragment@16/__overlay__/epa_elna_mtk:parts:44", "/fragment@16/__overlay__/epa_elna_mtk:parts:52";
		wlan3002c_laa = "/fragment@16/__overlay__/epa_elna_mtk:parts:20";
		qm45197_laa = "/fragment@16/__overlay__/epa_elna_mtk:parts:28";
		wlan7207h = "/fragment@16/__overlay__/epa_elna_mtk:parts:56", "/fragment@16/__overlay__/epa_elna_mtk:parts:64";
		wlan7205c = "/fragment@16/__overlay__/epa_elna_mtk:parts:60", "/fragment@16/__overlay__/epa_elna_mtk:parts:68";
		i2c6 = "/fragment@17:target:0", "/fragment@37:target:0", "/fragment@41:target:0", "/fragment@108:target:0";
		sound = "/fragment@18:target:0", "/fragment@42:target:0";
		afe = "/fragment@19:target:0";
		mt6363_vio18 = "/fragment@21:target:0", "/fragment@22/__overlay__/sx937x@2c:cap_vdd-supply:0", "/fragment@35/__overlay__/hall_pen_detect:hall_vdd-supply:0", "/fragment@36/__overlay__/hall_folio_detect:hall_vdd-supply:0";
		i2c7 = "/fragment@22:target:0";
		consys = "/fragment@23:target:0";
		spi3 = "/fragment@26:target:0";
		mt6368_vtp = "/fragment@26/__overlay__/goodix_ts_spi@0:vtouch-supply:0", "/fragment@26/__overlay__/focaltech@1:vcc_i2c-supply:0";
		mt6375_chg = "/fragment@26/__overlay__/goodix_ts_spi@0:mtk-charger:0", "/fragment@26/__overlay__/focaltech@1:mtk-charger:0", "/fragment@69:target:0";
		mt6368_vio28 = "/fragment@33:target:0";
		rt6160 = "/fragment@38:target:0";
		gate_ic = "/fragment@40:target:0";
		regulator_vibrator = "/fragment@43:target:0";
		clock_buffer_ctrl = "/fragment@44:target:0";
		i2c3 = "/fragment@45:target:0";
		spi5 = "/fragment@46:target:0";
		spi1 = "/fragment@48:target:0";
		soc = "/fragment@49:target:0", "/fragment@106:target:0";
		mt6368_vfp = "/fragment@49/__overlay__/fp_egistec:vcc_fp-supply:0", "/fragment@49/__overlay__/goodix_fp:fp,vdd-supply:0";
		tboard_thermistor4 = "/fragment@50:target:0", "/fragment@53/__overlay__/chg_ntc:thermal-sensors:0";
		mt6368_adc = "/fragment@50/__overlay__:io-channels:0", "/fragment@51/__overlay__:io-channels:0";
		tboard_thermistor5 = "/fragment@51:target:0", "/fragment@53/__overlay__/quiet_ntc:thermal-sensors:0";
		tboard_thermistor6 = "/fragment@52:target:0", "/fragment@53/__overlay__/tspk_ntc:thermal-sensors:0";
		pmic_adc = "/fragment@52/__overlay__:io-channels:0";
		thermal_zones = "/fragment@53:target:0", "/fragment@117:target:0";
		therm_intf = "/fragment@54:target:0";
		u2port0 = "/fragment@56:target:0";
		mmc1 = "/fragment@57:target:0";
		swtp = "/fragment@58:target:0", "/fragment@90:target:0";
		swtp_1 = "/fragment@59:target:0", "/fragment@91:target:0";
		swtp_2 = "/fragment@60:target:0", "/fragment@92:target:0";
		swtp_3 = "/fragment@61:target:0", "/fragment@94:target:0";
		swtp_4 = "/fragment@62:target:0", "/fragment@95:target:0";
		swtp_5 = "/fragment@63:target:0", "/fragment@98:target:0";
		swtp_6 = "/fragment@64:target:0", "/fragment@102:target:0";
		mtee_svp = "/fragment@65:target:0";
		i2c5 = "/fragment@66:target:0";
		mtk_gauge = "/fragment@67:target:0";
		lk_charger = "/fragment@70:target:0";
		mtk_ctd = "/fragment@71:target:0";
		charger = "/fragment@72:target:0";
		smart_battery = "/fragment@72/__overlay__:gauge:0", "/fragment@74:target:0", "/fragment@78/__overlay__:gauge:0", "/fragment@79/__overlay__:gauge:0", "/fragment@80/__overlay__:gauge:0", "/fragment@81/__overlay__:gauge:0", "/fragment@82/__overlay__:gauge:0";
		moto_chg_tcmd = "/fragment@73:target:0";
		i2c0 = "/fragment@76:target:0";
		mt6375_auxadc = "/fragment@76/__overlay__/NFG1000@55:io-channels:0", "/fragment@76/__overlay__/NFG1000@55:io-channels:8";
		pd_adapter = "/fragment@77:target:0";
		pdc = "/fragment@78:target:0";
		pe = "/fragment@79:target:0";
		pe4 = "/fragment@80:target:0";
		pe2 = "/fragment@81:target:0";
		pe5 = "/fragment@82:target:0";
		charge_leds = "/fragment@84:target:0";
		charger_cooler = "/fragment@85:target:0";
		extcon_usb = "/fragment@86:target:0";
		gpio_usage_mapping = "/fragment@87:target:0";
		gpio = "/fragment@88:target:0";
		subpmic_pmu_eint = "/fragment@89:target:0";
		irq_nfc = "/fragment@93:target:0";
		touch_panel = "/fragment@96:target:0";
		rt5133_eint = "/fragment@97:target:0";
		hall_3 = "/fragment@99:target:0";
		hall_4 = "/fragment@100:target:0";
		dsi_te = "/fragment@101:target:0";
		md1_sim1_hot_plug_eint = "/fragment@103:target:0";
		md1_sim2_hot_plug_eint = "/fragment@104:target:0";
		keypad = "/fragment@105:target:0";
		mtk_composite_v4l2_2 = "/fragment@107:target:0";
		i2c2 = "/fragment@109:target:0", "/fragment@114:target:0";
		i2c8 = "/fragment@110:target:0", "/fragment@116:target:0";
		mtk_composite_v4l2_1 = "/fragment@111:target:0";
		seninf_top = "/fragment@112:target:0";
		csi_efuse0 = "/fragment@112/__overlay__/seninf_csi_port_0:nvmem-cells:0";
		csi_efuse1 = "/fragment@112/__overlay__/seninf_csi_port_1:nvmem-cells:0";
		csi_efuse2 = "/fragment@112/__overlay__/seninf_csi_port_2:nvmem-cells:0";
		topckgen_clk = "/fragment@114/__overlay__/sensor0@20:clocks:0", "/fragment@114/__overlay__/sensor0@20:clocks:8", "/fragment@114/__overlay__/sensor0@20:clocks:16", "/fragment@114/__overlay__/sensor0@20:clocks:24", "/fragment@114/__overlay__/sensor0@20:clocks:32", "/fragment@114/__overlay__/sensor0@20:clocks:40", "/fragment@114/__overlay__/sensor0@20:clocks:48", "/fragment@114/__overlay__/sensor0@20:clocks:56", "/fragment@114/__overlay__/sensor0@20:clocks:64", "/fragment@115/__overlay__/sensor1@20:clocks:0", "/fragment@115/__overlay__/sensor1@20:clocks:8", "/fragment@115/__overlay__/sensor1@20:clocks:16", "/fragment@115/__overlay__/sensor1@20:clocks:24", "/fragment@115/__overlay__/sensor1@20:clocks:32", "/fragment@115/__overlay__/sensor1@20:clocks:40", "/fragment@115/__overlay__/sensor1@20:clocks:48", "/fragment@115/__overlay__/sensor1@20:clocks:56", "/fragment@115/__overlay__/sensor1@20:clocks:64", "/fragment@116/__overlay__/sensor2@40:clocks:0", "/fragment@116/__overlay__/sensor2@40:clocks:8", "/fragment@116/__overlay__/sensor2@40:clocks:16", "/fragment@116/__overlay__/sensor2@40:clocks:24", "/fragment@116/__overlay__/sensor2@40:clocks:32", "/fragment@116/__overlay__/sensor2@40:clocks:40", "/fragment@116/__overlay__/sensor2@40:clocks:48", "/fragment@116/__overlay__/sensor2@40:clocks:56", "/fragment@116/__overlay__/sensor2@40:clocks:64";
		i2c4 = "/fragment@115:target:0";
	};

	__local_fixups__ {

		fragment@6 {

			__overlay__ {
				pinctrl-0 = <0x00>;
				pinctrl-1 = <0x00>;
				pinctrl-2 = <0x00>;
				pinctrl-3 = <0x00>;
				pinctrl-4 = <0x00>;
				pinctrl-5 = <0x00>;
				pinctrl-6 = <0x00>;
			};
		};

		fragment@8 {

			__overlay__ {
				pinctrl-0 = <0x00>;
				pinctrl-1 = <0x00>;
			};
		};

		fragment@9 {

			__overlay__ {
				pinctrl-0 = <0x00>;
				pinctrl-1 = <0x00>;
				pinctrl-2 = <0x00>;
				pinctrl-3 = <0x00>;
			};
		};

		fragment@10 {

			__overlay__ {

				port {

					endpoint@0 {
						remote-endpoint = <0x00>;
					};
				};
			};
		};

		fragment@11 {

			__overlay__ {

				port {

					endpoint@0 {
						remote-endpoint = <0x00>;
					};
				};
			};
		};

		fragment@13 {

			__overlay__ {
				pinctrl-0 = <0x00>;
				pinctrl-1 = <0x00>;
				pinctrl-2 = <0x00>;
				pinctrl-3 = <0x00>;
				pinctrl-4 = <0x00>;
			};
		};

		fragment@14 {

			__overlay__ {
				pinctrl-0 = <0x00>;
				pinctrl-1 = <0x00>;
				pinctrl-2 = <0x00>;
			};
		};

		fragment@15 {

			__overlay__ {

				ports {

					port {

						endpoint {
							remote-endpoint = <0x00>;
						};
					};
				};
			};
		};

		fragment@18 {

			__overlay__ {

				mediatek,speaker-codec {
					sound-dai = <0x00>;
				};
			};
		};

		fragment@19 {

			__overlay__ {
				pinctrl-0 = <0x00>;
				pinctrl-1 = <0x00>;
				pinctrl-2 = <0x00>;
				pinctrl-3 = <0x00>;
				pinctrl-4 = <0x00>;
				pinctrl-5 = <0x00>;
				pinctrl-6 = <0x00>;
				pinctrl-7 = <0x00>;
				pinctrl-8 = <0x00>;
				pinctrl-9 = <0x00>;
				pinctrl-10 = <0x00>;
				pinctrl-11 = <0x00>;
				pinctrl-12 = <0x00>;
				pinctrl-13 = <0x00>;
				pinctrl-14 = <0x00>;
				pinctrl-15 = <0x00>;
				pinctrl-16 = <0x00>;
				pinctrl-17 = <0x00>;
				pinctrl-18 = <0x00>;
				pinctrl-19 = <0x00>;
			};
		};

		fragment@22 {

			__overlay__ {

				sx937x@2c {
					pinctrl-0 = <0x00>;
					pinctrl-1 = <0x00>;
				};

				awinic_sar@12 {
					pinctrl-0 = <0x00>;
					pinctrl-1 = <0x00>;
				};
			};
		};

		fragment@23 {

			__overlay__ {
				pinctrl-0 = <0x00>;
				pinctrl-1 = <0x00>;
				pinctrl-2 = <0x00>;
			};
		};

		fragment@26 {

			__overlay__ {
				pinctrl-0 = <0x00>;
				pinctrl-1 = <0x00>;
				pinctrl-2 = <0x00>;
				pinctrl-3 = <0x00>;
				pinctrl-4 = <0x00>;
				pinctrl-5 = <0x00>;

				goodix_ts_spi@0 {
					pinctrl-0 = <0x00 0x04>;
					pinctrl-1 = <0x00 0x04>;
					pinctrl-2 = <0x00>;
					pinctrl-3 = <0x00>;
				};

				focaltech@1 {
					pinctrl-0 = <0x00 0x04>;
					pinctrl-1 = <0x00 0x04>;
					pinctrl-2 = <0x00>;
				};
			};
		};

		fragment@30 {

			__overlay__ {
				pinctrl-0 = <0x00>;
				pinctrl-1 = <0x00>;
				pinctrl-2 = <0x00>;
				pinctrl-3 = <0x00>;
				pinctrl-4 = <0x00>;
				pinctrl-5 = <0x00>;
			};
		};

		fragment@32 {

			__overlay__ {

				panel1@0 {

					port {

						endpoint {
							remote-endpoint = <0x00>;
						};
					};
				};

				panel2@0 {

					port {

						endpoint {
							remote-endpoint = <0x00>;
						};
					};
				};

				panel3@0 {

					port {

						endpoint {
							remote-endpoint = <0x00>;
						};
					};
				};

				panel4@0 {

					port {

						endpoint {
							remote-endpoint = <0x00>;
						};
					};
				};
			};
		};

		fragment@35 {

			__overlay__ {

				hall_pen_detect {
					pinctrl-0 = <0x00>;
					pinctrl-1 = <0x00>;
				};
			};
		};

		fragment@36 {

			__overlay__ {

				hall_folio_detect {
					pinctrl-0 = <0x00>;
					pinctrl-1 = <0x00>;
				};
			};
		};

		fragment@42 {

			__overlay__ {

				mediatek,speaker-codec {
					sound-dai = <0x00 0x04>;
				};
			};
		};

		fragment@46 {

			__overlay__ {

				p61@0 {
					pinctrl-0 = <0x00>;
					pinctrl-1 = <0x00>;
				};
			};
		};

		fragment@49 {

			__overlay__ {

				fp_egistec {
					pinctrl-0 = <0x00>;
					pinctrl-1 = <0x00>;
					pinctrl-2 = <0x00>;
					pinctrl-3 = <0x00>;
					pinctrl-4 = <0x00>;
				};

				goodix_fp {
					pinctrl-0 = <0x00>;
					pinctrl-1 = <0x00>;
					pinctrl-2 = <0x00>;
				};
			};
		};

		fragment@76 {

			__overlay__ {

				bq25960-master@66 {
					pinctrl-0 = <0x00>;
				};

				bq25960-slave@67 {
					pinctrl-0 = <0x00>;
				};
			};
		};

		fragment@107 {

			__overlay__ {

				port@0 {

					endpoint {
						remote-endpoint = <0x00>;
					};
				};

				port@1 {

					endpoint {
						remote-endpoint = <0x00>;
					};
				};
			};
		};

		fragment@108 {

			__overlay__ {

				aw36518@63 {

					flash@0 {

						port@0 {

							endpoint {
								remote-endpoint = <0x00>;
							};
						};
					};
				};
			};
		};

		fragment@109 {

			__overlay__ {

				camera_af_main@18 {
					vdd-supply = <0x00>;

					port {

						endpoint {
							remote-endpoint = <0x00>;
						};
					};
				};
			};
		};

		fragment@110 {

			__overlay__ {

				camera_af_wide@18 {
					vin-supply = <0x00>;

					port {

						endpoint {
							remote-endpoint = <0x00>;
						};
					};
				};
			};
		};

		fragment@111 {

			__overlay__ {

				port@0 {

					endpoint {
						remote-endpoint = <0x00>;
					};
				};
			};
		};

		fragment@112 {

			__overlay__ {

				seninf_csi_port_0 {

					port {

						endpoint {
							remote-endpoint = <0x00>;
						};
					};
				};

				seninf_csi_port_1 {

					port {

						endpoint {
							remote-endpoint = <0x00>;
						};
					};
				};

				seninf_csi_port_2 {

					port {

						endpoint {
							remote-endpoint = <0x00>;
						};
					};
				};
			};
		};

		fragment@114 {

			__overlay__ {

				sensor0@20 {
					pinctrl-0 = <0x00>;
					pinctrl-1 = <0x00>;
					pinctrl-2 = <0x00>;
					pinctrl-3 = <0x00>;
					pinctrl-4 = <0x00>;
					pinctrl-5 = <0x00>;
					pinctrl-6 = <0x00>;
					avdd-supply = <0x00>;
					dvdd-supply = <0x00>;
					dovdd-supply = <0x00>;

					port {

						endpoint {
							remote-endpoint = <0x00>;
						};
					};
				};
			};
		};

		fragment@115 {

			__overlay__ {

				sensor1@20 {
					pinctrl-0 = <0x00>;
					pinctrl-1 = <0x00>;
					pinctrl-2 = <0x00>;
					pinctrl-3 = <0x00>;
					pinctrl-4 = <0x00>;
					pinctrl-5 = <0x00>;
					pinctrl-6 = <0x00>;
					avdd-supply = <0x00>;
					dvdd-supply = <0x00>;
					dovdd-supply = <0x00>;

					port {

						endpoint {
							remote-endpoint = <0x00>;
						};
					};
				};
			};
		};

		fragment@116 {

			__overlay__ {

				sensor2@40 {
					pinctrl-0 = <0x00>;
					pinctrl-1 = <0x00>;
					pinctrl-2 = <0x00>;
					pinctrl-3 = <0x00>;
					pinctrl-4 = <0x00>;
					pinctrl-5 = <0x00>;
					pinctrl-6 = <0x00>;
					avdd-supply = <0x00>;
					dvdd-supply = <0x00>;
					dovdd-supply = <0x00>;

					port {

						endpoint {
							remote-endpoint = <0x00>;
						};
					};
				};
			};
		};

		fragment@117 {

			__overlay__ {

				camera0 {
					thermal-sensors = <0x00>;
				};

				camera1 {
					thermal-sensors = <0x00>;
				};

				camera2 {
					thermal-sensors = <0x00>;
				};
			};
		};
	};
};
