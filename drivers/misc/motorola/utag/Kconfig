## drivers/misc/motorola/utag/Kconfig
```kconfig
config MMI_UTAGS
	tristate "Motorola UTAGS storage"
	depends on OF && PROC_FS && BLOCK
	help
	  Exposes Motorola UTAGS persistent key/value storage through procfs
	  and reads/writes backing UTAGS partitions from device tree paths.
```

## drivers/nfc/mmi_nfc_clk/Kconfig
```kconfig
config MMI_NFC_CLK
	bool "Motorola MMI NFC clock helper"
	depends on OF && GPIOLIB
	help
	  Enables Motorola NFC clock request GPIO wake helper used by
	  device trees exposing compatible "mmi,nfc-clk".
```

## drivers/tee/gud/Kconfig
```kconfig
#
# TRUSTONIC TEE configuration
#
config TRUSTONIC_TEE_SUPPORT
	tristate "Enable Trustonic TEE Support"
	help
	  Enable Trustonic TEE Support.
	  This option enables MobiCore Driver which is used to communicate with
	  TEE OS, for things like, setting up log buffers, interrupt pins,
	  and IPC channels.

config TRUSTONIC_TEE_VERSION
	string "TRUSTONIC TEE Version"
	depends on TRUSTONIC_TEE_SUPPORT
	default "610"
	help
	  Select the MobiCore/Kinibi driver version that matches the TEE binary
	  in /vendor.  Supported values: 500, 510, 600, 610.
	  600: Kinibi 600 series (adds ARM FFA stubs, protocol_version.h).
	  610: Kinibi 610 series (600 + RAITE backend).

config TRUSTONIC_TEE_DEBUG
	bool "Trustonic TEE driver debug mode"
	depends on TRUSTONIC_TEE_SUPPORT
	help
	  Enable the debug mode in the Trustonic TEE Driver.
	  Unlike MOBICORE_DEBUG and MOBICORE_VERBOSE used in TBASE 302 series,
	  TBASE 311 series use one option to turn on necessary debug logs.
	  Enable this option for debugging and see more detailed driver flow.

config TRUSTONIC_TRUSTED_UI
	tristate "<t-base TUI"
	depends on TRUSTONIC_TEE_SUPPORT
	help
	  Enable <t-base Trusted User Interface
	  Trustonic TUI features was based on Trustonic TEE mechanism to protect
	  Touch/Display inside TEE, to prevent malicious access of sensitive
	  data used by APPs like Banking.

config TRUSTONIC_TRUSTED_UI_FB_BLANK
	bool "Trustonic Trusted UI with fb_blank"
	depends on TRUSTONIC_TRUSTED_UI
	help
	  Blank the framebuffer before starting a TUI session.
	  Trustonic TUI features was based on Trustonic TEE mechanism to protect
	  Touch/Display inside TEE, to prevent malicious access of sensitive data
	  used by APPs like Banking.

config FSCRYPT_WRAPED_KEY_MODE_SUPPORT
	bool "Wrapped Key support for FSCRYPT V2"
	depends on TRUSTONIC_TEE_SUPPORT
	help
	  Enable Fscrypt V2 wrapped key support
	  This option enables keymaster in mobicore drive which is used to communicate with
	  TEE OS, for things like, wrapped key programming, wrapped key derivation,
	  and key unwrapping.
```

## drivers/video/backlight/motorola/Kconfig
```kconfig
menu "Motorola Backlight Support"

config BACKLIGHT_AW99703
	tristate "Awinic AW99703 Backlight support"
	depends on I2C

config BACKLIGHT_KTD3136
	tristate "Kinetix KTD3136 Backlight support"
	depends on I2C

config BACKLIGHT_LM3697
	tristate "TI LM3697 Backlight support"
	depends on I2C

config BACKLIGHT_SM5350
	tristate "Silicon Mitus SM5350 Backlight support"
	depends on I2C

endmenu
```

## fs/ksmbd/Kconfig
```kconfig
# SPDX-License-Identifier: GPL-2.0-only
#
# smbfs configuration

source "fs/ksmbd/client/Kconfig"
source "fs/ksmbd/server/Kconfig"

config SMBFS
	tristate
	default y if CIFS=y || SMB_SERVER=y
	default m if CIFS=m || SMB_SERVER=m
```

## fs/netfs/Kconfig
```kconfig
menu "NetFS (Network Filesystem Support)"

config NETFS_SUPPORT
	tristate "NetFS support layer"
	help
	  Support for caching and higher-level I/O management for network
	  filesystems.

endmenu
```
