## drivers/misc/mediatek/ram_console/Kconfig
```kconfig
# SPDX-License-Identifier: GPL-2.0

config MTK_RAM_CONSOLE
	bool "MediaTek RAM console (last-kmsg via pstore/ramoops)"
	depends on PSTORE_RAM
	depends on MTK_AEE_IPANIC
	default n
	help
	  Enables the MediaTek RAM console driver for the Dimensity 7030
	  (MT6879) platform. The driver:
	
	    * Exposes the previous boot kernel console as /proc/last_kmsg
	      so Android init and bugreport tools can retrieve it early.
	
	    * Reads the bootloader "ram_console" property from /chosen
	      (if present) and appends that SRAM/DRAM log region.
	
	  The persistent write path is provided by aee_sram_printk() from
	  the MTK AEE/mrdump subsystem (CONFIG_MTK_AEE_IPANIC), while
	  CONFIG_PSTORE_RAM plus the ramoops node keeps cross-reboot logs.
	
	  Say Y here to enable debugging of custom-kernel boot failures.
	  If unsure, say N.
```

## drivers/misc/mediatek/scpsys/Kconfig
```kconfig
config VIDEO_MTK_ISP_AOV
	tristate "Mediatek Always-On Vision (AOV) driver"
	help
	  Always-On Vision (AOV) driver for MediaTek SoCs.
	  Provides always-on face detection and AI vision processing
	  on the SCP (System Control Processor) subsystem.
	  Used with ISP7S/ISP7SP on MT6879/Dimensity 7030.

	  Choose m or y to enable this driver.
```

## drivers/misc/mediatek/upower/Kconfig
```kconfig
config MTK_UNIFIED_POWER
	tristate "MediaTek unified power Module"
	depends on (MTK_PLAT_POWER_MT6768 || MTK_PLAT_POWER_MT6765 || MTK_PLAT_POWER_MT6833 || MTK_PLAT_POWER_MT6761 || MTK_PLAT_POWER_MT6739)
	help
	  This driver provides unified power management for MediaTek platforms.
	  Requires platform-specific power data (MTK_PLAT_POWER_*). If none of
	  the supported platform symbols are enabled, this driver will not be
	  selected to avoid NULL dereference at early init.

config MTK_EEM_READY
	def_bool y
	depends on MTK_PTPOD_LEGACY
	help
	  This driver depends PPM
	  Select "y" if you want to enable this features.
	  Select "n" if unsure.
```

## drivers/misc/motorola/Kconfig
```kconfig
# SPDX-License-Identifier: GPL-2.0-only

menu "Motorola misc drivers"

config MMI_RELAY
	tristate "Motorola MMI relay driver"
	depends on OF
	help
	  This driver provides the Motorola internal notifier relay used by
	  vendor subsystems.

config MOTO_BINDER
	tristate "Motorola binder optimization driver"
	depends on ANDROID_BINDER_IPC && NET && PROC_FS
	help
	  This driver adds Motorola binder telemetry and optimization hooks.

config MOTO_MMAP_FAULT
	tristate "Motorola mmap fault tuning driver"
	depends on ANDROID_VENDOR_HOOKS
	help
	  This driver tunes mmap readaround behavior through Android vendor
	  trace hooks.

config MOTO_MM
	tristate "Motorola memory management hooks"
	depends on ANDROID_VENDOR_HOOKS
	help
	  Enables Motorola memory tuning hooks for vmscan policies.

config MOTO_SCHED
	tristate "Motorola scheduler optimizations"
	depends on PROC_FS
	help
	  Enables Motorola scheduler optimization and ux inheritance logic.

config MOTO_F_MASS_STORAGE
	bool "Motorola USB mass storage function"
	depends on USB_GADGET && USB_CONFIGFS
	help
	  Enables Motorola mass storage USB gadget function integration.

config MOTO_F_USBNET
	bool "Motorola USB usbnet function"
	depends on USB_GADGET && USB_CONFIGFS && NET
	help
	  Enables Motorola usbnet USB gadget function integration.

config MOTO_CON_DFPAR
	bool "Motorola con_dfpar network diagnostics"
	depends on NET && NETFILTER && PROC_FS
	help
	  Enables Motorola connectivity packet diagnostics hooks.

config MMI_INFO
	bool "Motorola mmi info"
	depends on OF
	help
	  Exposes Motorola device information helpers and boot properties.

config MMI_UTAGS
	tristate "Motorola UTAGS storage"
	depends on OF && PROC_FS && BLOCK
	help
	  Exposes Motorola UTAGS persistent key/value storage through procfs
	  and reads/writes backing UTAGS partitions from device tree paths.

config MMI_ANNOTATE
	bool "Motorola mmi annotate"
	depends on OF && PROC_FS
	help
	  Exposes persistent and runtime annotation interface for debugging.

config MMI_SYS_TEMP
	tristate "Motorola system temperature bridge"
	depends on OF && THERMAL && POWER_SUPPLY
	help
	  Exposes Motorola system temperature IOCTL bridge and virtual
	  thermal zones for user space temperature publishers.

config MMI_MUC_UART
	bool "Motorola MUC UART"
	depends on OF && TTY && POWER_SUPPLY && FW_LOADER
	help
	  Enables Motorola Mod/USB controller UART communication stack.

config MOTO_FM_CTRL
	bool "Motorola FM control interface"
	depends on OF && PINCTRL
	help
	  Enables Motorola FM control interface driver (ELNA pinctrl toggling).

config MOTO_UWB_SR100
	bool "Motorola UWB SR100 interface"
	depends on OF && SPI
	help
	  Enables Motorola SR100 UWB control interface over SPI.

config MOTO_SENSORS_CLASS
	bool "Motorola sensors class"
	depends on SYSFS
	help
	  Enables Motorola sensors class interface used by vendor sensor drivers.

config MOTO_SX937X_SAR
	bool "Motorola SX937X SAR sensor"
	depends on I2C && OF && MOTO_SENSORS_CLASS
	help
	  Enables Motorola SX937X SAR proximity sensor driver used on manaus.

config MOTO_AWINIC_SAR
	bool "Motorola Awinic SAR sensor"
	depends on I2C && OF && MOTO_SENSORS_CLASS
	help
	  Enables Motorola Awinic AW96xx SAR sensor driver used on manaus.

source "drivers/misc/motorola/mm_iosched/Kconfig"
source "drivers/misc/motorola/moto_swap/Kconfig"
source "drivers/misc/motorola/moto_sched/Kconfig"

endmenu

config MOTO_HALL
	tristate "Motorola Hall sensor support"
	depends on I2C

config MOTO_PEN
	tristate "Motorola Pen support"
	depends on I2C

config MOTO_ABOV
	tristate "Motorola Abov MCU support"
	depends on I2C

config MOTO_AW9610X
	tristate "Awinic AW9610X SAR sensor support"
	depends on I2C

config MOTO_SX9310
	tristate "Semtech SX9310 SAR sensor support"
	depends on I2C

config MOTO_SX9325
	tristate "Semtech SX9325 SAR sensor support"
	depends on I2C

config MOTO_SX933X
	tristate "Semtech SX933X SAR sensor support"
	depends on I2C

config MOTO_SIGPRINT
	tristate "Motorola Signature Print support"

config MOTO_TPS61280
	tristate "TI TPS61280 Boost converter support"
	depends on I2C

config INPUT_DRV2624_MMI
	tristate "Motorola DRV2624 haptic support"
	depends on I2C
```

## drivers/misc/motorola/mm_iosched/Kconfig
```kconfig
# SPDX-License-Identifier: GPL-2.0

config MOTO_IOSCHED
  bool "Motorola io sched"
  depends on BLOCK && MOTO_SCHED
  default n
  help
    Motorola I/O scheduler extension integrated with moto sched hints.
```

## drivers/misc/motorola/moto_sched/Kconfig
```kconfig
# SPDX-License-Identifier: GPL-2.0

config MOTO_FUTEX_INHERIT
  bool "futex inherit"
  depends on MOTO_SCHED
  default n
  help
    Boost futex owner for the blocked UX thread.

config MOTO_RWSEM_INHERIT
  bool "rwsem inherit"
  depends on MOTO_SCHED
  default y if MTK_SCHED_VIP_TASK
  default n
  help
    Boost rwsem owner for the blocked UX thread.

config MOTO_MUTEX_INHERIT
  bool "mutex inherit"
  depends on MOTO_SCHED
  default y if MTK_SCHED_VIP_TASK
  default n
  help
    Boost mutex owner for the blocked UX thread.
```
