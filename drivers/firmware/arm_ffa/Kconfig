## drivers/firmware/arm_ffa/Kconfig
```kconfig
# SPDX-License-Identifier: GPL-2.0-only
#
# Arm Firmware Framework for Arm (FF-A) Transport
#

config ARM_FFA_TRANSPORT
	tristate "Arm Firmware Framework for Arm (FF-A) driver"
	depends on ARM64
	select ARM_PSCI_FW
	help
	  This driver implements the Arm Firmware Framework for Arm (FF-A 1.0,
	  DEN0077A) secure-world transport.  It detects FFA support by probing
	  the FFA_VERSION Secure Monitor Call (SMC) at boot — no Device Tree
	  node is required.  When FFA support is confirmed the driver maps the
	  mandatory RXTX buffer pair, discovers Secure-world partitions, and
	  registers them on the FFA virtual bus so that client drivers (e.g.
	  Trustonic MobiCore 610) can bind to them.

	  Say Y if your platform uses an FFA-capable Secure Monitor (e.g. the
	  Trustonic Kinibi 600/610 TEE on MediaTek MT6879/Dimensity 7030).
	  Say M to build as a module.
```

## drivers/gpu/mediatek/gpu_mali/mali_avalon/mali-r49p1/drivers/gpu/arm/midgard/arbitration/Kconfig
```kconfig
# SPDX-License-Identifier: GPL-2.0 WITH Linux-syscall-note
# Configuración Canonizada para Soporte Nativo (Built-in)

config BSP_HAS_HYPERVISOR
	bool "Native Hypervisor Support"
	depends on MALI_MIDGARD && !GPU_HAS_CSF
	default y
	select MALI_ARBITRATION
	help
	  Activa el soporte nativo para hipervisores dentro del kernel. 
	  Optimizado para virtualización de baja latencia en MT6879.

config MALI_HAS_ARBITER
	bool "Mali Hardware Arbiter (Static)"
	depends on MALI_MIDGARD
	default y if BSP_HAS_HYPERVISOR
	help
	  Compila el árbitro de GPU directamente en el kernel. 
	  Evita la sobrecarga de los módulos .ko tradicionales.

config MALI_ARBITER_LOST_TEST
	bool "Aggressive GPU_LOST testing"
	depends on MALI_HAS_ARBITER && DEBUG_KERNEL
	default n
	help
	  Solo habilitar para pruebas de estrés en el desarrollo del kernel.
```

## drivers/gud/Kconfig
```kconfig
menu "MobiCore GUD support"

config MOBICORE_DRIVER
	tristate "MobiCore Driver"
	depends on !TRUSTONIC_TEE_SUPPORT
	default y
	help
	  MobiCore Driver for TrustZone communication.
	  Do NOT enable together with TRUSTONIC_TEE_SUPPORT: both compile
	  the same mcDrvModule symbols (mmu, iwp, session, etc.) and the
	  linker will report duplicate-symbol errors.  On platforms using
	  the Kinibi 610 stack, select TRUSTONIC_TEE_SUPPORT instead.

endmenu
```

## drivers/kernelsu/kernel/Kconfig
```kconfig
menu "KernelSU"

config KSU
	tristate "KernelSU function support"
	depends on KPROBES
	default y
	help
	  Enable kernel-level root privileges on Android System.
	  Requires CONFIG_KPROBES for kernel hooking support.
	  To compile as a module, choose M here: the
	  module will be called kernelsu.

config KSU_DEBUG
	bool "KernelSU debug mode"
	depends on KSU
	default n
	help
	  Enable KernelSU debug mode.

menu "KernelSU - SUSFS"

config KSU_SUSFS
	tristate "KernelSU addon - SUSFS"
	depends on KSU
	default y
	help
	  Patch and enable SUSFS integration in kernel with KernelSU.

config KSU_SUSFS_SUS_PATH
	tristate "Enable to hide suspicious path"
	depends on KSU_SUSFS
	default y

config KSU_SUSFS_SUS_MOUNT
	tristate "Enable to hide suspicious mounts"
	depends on KSU_SUSFS
	default y

config KSU_SUSFS_SUS_MOUNT_MNT_ID_REORDER
	tristate "Enable mount id reorder in mountinfo (experimental)"
	depends on KSU_SUSFS_SUS_MOUNT
	default n

config KSU_SUSFS_SUS_KSTAT
	tristate "Enable to spoof suspicious kstat"
	depends on KSU_SUSFS
	default y

config KSU_SUSFS_SUS_MAPS
	tristate "Enable to spoof suspicious maps"
	depends on KSU_SUSFS
	default y

config KSU_SUSFS_SUS_PROC_FD_LINK
	tristate "Enable to spoof suspicious proc fd links (experimental)"
	depends on KSU_SUSFS
	default n

config KSU_SUSFS_SUS_MEMFD
	tristate "Enable to hide/spoof suspicious memfd (experimental)"
	depends on KSU_SUSFS
	default n

config KSU_SUSFS_TRY_UMOUNT
	tristate "Enable to use ksu try_umount"
	depends on KSU_SUSFS
	default y

config KSU_SUSFS_SPOOF_UNAME
	tristate "Enable to spoof uname"
	depends on KSU_SUSFS
	default y

config KSU_SUSFS_ENABLE_LOG
	tristate "Enable SUSFS logging"
	depends on KSU_SUSFS
	default y

endmenu

endmenu
```

## drivers/media/platform/mtk-aie/Kconfig
```kconfig
config MTK_CAMERA_FD_ISP7
	tristate "Mediatek AI engine function"
	select V4L2_MEM2MEM_DEV
	depends on VIDEOBUF2_DMA_CONTIG
	help
		Support the AI engine (AIE) feature

		AIE driver is a V4L2 memory-to-memory device driver which
		provides hardware accelerated face detection function,
		it can detect different sizes of faces in a raw image.

config MTK_CAMERA_FD_ISP7S_ISP7SP
	tristate "Mediatek AI engine for ISP7S/ISP7SP"
	select V4L2_MEM2MEM_DEV
	depends on VIDEOBUF2_DMA_CONTIG
	help
		Support the AI engine (AIE) feature for ISP7S and ISP7SP SoCs.

		This driver provides hardware accelerated face detection for
		MediaTek ISP7S (MT6879/Dimensity 7030) and ISP7SP platforms,
		including the isp7s and isp7sp driver variants.
```

## drivers/misc/mediatek/cam_cal/Kconfig
```kconfig
config MTK_CAM_CAL
	tristate "MTK camera cal driver"
	help
	  This module is used for reading calibration data of camera which
	  stored in EEPROM component.
	  CONFIG_MTK_CAM_CAL define if the camera cal driver should be
	  built in or not. If you want to use EEPROM which contains
	  calibration data for sensor. You have enable CONFIG_MTK_CAM_CAL
	  on ProjectConfig. The kernel space for EEPROM will be build.
	  It may be like as "/dev/camera_eeprom0".
	  User space code will control the driver by open and read this one.

config MTK_CAM_CAL_V4L2
	tristate "MTK camera cal V4L2 EEPROM driver"
	help
	  V4L2-based EEPROM calibration data driver for MediaTek camera.
	  This is the newer V4L2 interface for reading EEPROM calibration
	  data. Enable this for ISP7x-based platforms (ISP71, ISP7S, ISP7SP).

config MTK_EEPROM_PROJECT
	string "MTK EEPROM project name"
	default ""
	help
	  Set the project name for EEPROM layout selection.
	  Used by the cam_cal V4L2 driver to select project-specific
	  calibration data layouts.

config MTK_VICKY_EEPROM_PROJECT
	tristate "set imgsensor vicky eeprom name"
	help
	  This config is set as sensor eeprom name
	  which project sensor used for.
```

## drivers/misc/mediatek/cameraisp/dpe/Kconfig
```kconfig
config MTK_CAMERA_DPE_ISP7
	tristate "[DPE] Depth Engine"
	depends on MTK_CAMERA_ISP_SUPPORT
	help
	  Depth Engine.
	  Enable to calculate the depth information
	  between two images on Dual Camera Application.
	  Disable if it is not supported or not wanted.

config MTK_CAMERA_DPE_ISP6S
	tristate "[DPE] Depth Engine"
	depends on MTK_CAMERA_ISP_SUPPORT
	help
	  Depth Engine.
	  Enable to calculate the depth information
	  between two images on Dual Camera Application.
	  Disable if it is not supported or not wanted.

config MTK_CAMERA_DPE_ISP7S
	tristate "[DPE] Depth Engine for ISP7S"
	depends on MTK_CAMERA_ISP_SUPPORT
	help
	  Depth Processing Engine for ISP7S (MT6879/Dimensity 7030).
	  Enable to calculate depth information between stereo camera images.
	  Disable if not supported or not wanted.

config MTK_CAMERA_DPE_ISP7SP
	tristate "[DPE] Depth Engine for ISP7SP"
	depends on MTK_CAMERA_ISP_SUPPORT
	help
	  Depth Processing Engine for ISP7SP platforms.
	  Enable to calculate depth information between stereo camera images.
	  Disable if not supported or not wanted.
```

## drivers/misc/mediatek/ccu/src/Kconfig
```kconfig
config MTK_CCU
	tristate "MTK_CCU"
	help
	  Support 3A using CCU hardware
	  Offers speed up of 3A, including
	  Faster control flow and
	  Stabler frame rate.

config MTK_CCU_RPROC
	tristate "MTK CCU remoteproc driver for ISP71"
	depends on REMOTEPROC
	help
	  Support CCU (Camera Control Unit) as a remoteproc device
	  for ISP71-based platforms (MT6879/Dimensity 7030).
	  The CCU handles 3A algorithms offloaded to a dedicated
	  co-processor, communicating via IPI (Inter-Processor Interrupt).
```

## drivers/misc/mediatek/connectivity/Kconfig
```kconfig
# drivers/misc/mediatek/connectivity/Kconfig

menuconfig MTK_CONNECTIVITY
	bool "MediaTek Connectivity Support (In-Tree)"
	default y
	help
	  Habilita el soporte para los módulos de conectividad de MediaTek (BT, WIFI, GPS, FM).
	  Esta configuración integra los repositorios de proveedores directamente en el kernel.

if MTK_CONNECTIVITY

config MTK_CONN_SOC_MT6879
	bool "MT6879 (Dimensity 7030) Connectivity Support"
	default y
	help
	  Habilitar soporte específico para el SoC MT6879 (Motorola Edge 40 Neo).

# Flag Maestro de Robustecimiento para Virtualización
config MTK_WLAN_VIRT_ISOLATION
	bool "Enable Native Virtualization Isolation (MPU & Throttle Guard)"
	default y
	help
	  Activa el aislamiento de memoria EMI y el límite de throttling térmico
	  para garantizar estabilidad en entornos de virtualización nativa.

# Fuentes de Subsistemas
source "drivers/misc/mediatek/connectivity/common/Kconfig"
source "drivers/misc/mediatek/connectivity/conninfra/Kconfig"
source "drivers/misc/mediatek/connectivity/connfem/Kconfig"
source "drivers/misc/mediatek/connectivity/wlan/Kconfig"
source "drivers/misc/mediatek/connectivity/bt/Kconfig"
source "drivers/misc/mediatek/connectivity/gps/Kconfig"
source "drivers/misc/mediatek/connectivity/fmradio/Kconfig"

endif # MTK_CONNECTIVITY
```

## drivers/misc/mediatek/connectivity/bt/Kconfig
```kconfig
# drivers/misc/mediatek/connectivity/bt/Kconfig

menuconfig MTK_CONN_BT
	tristate "MediaTek Bluetooth Driver Support"
	depends on MTK_CONNECTIVITY && MTK_CONN_COMMON
	default y
	help
	  Habilita el soporte para el driver de Bluetooth de MediaTek.
	  Este driver es necesario para las funcionalidades de BT/BLE en dispositivos MTK.

if MTK_CONN_BT

# Enlazamos con el Kconfig del SoC específico que acabas de organizar
source "drivers/misc/mediatek/connectivity/bt/mt6879/Kconfig"

endif # MTK_CONN_BT
```

## drivers/misc/mediatek/connectivity/bt/mt6879/Kconfig
```kconfig
# drivers/misc/mediatek/connectivity/bt/mt6879/Kconfig

config MTK_CONN_BT_6879
	bool "MT6879 (Edge 40 Neo) BT Platform Support"
	depends on MTK_CONN_BT
	default y
	help
	  Activa el soporte específico para la plataforma MT6879.
	  Esto incluye el uso de la interfaz BEIF y las rutas de registros
	  optimizadas para el Motorola Edge 40 Neo.
```

## drivers/misc/mediatek/connectivity/common/Kconfig
```kconfig
config MTK_CONN_COMMON
	tristate "MediaTek Connectivity Common Driver (WMT/STP) - In-Tree"
	depends on MTK_CONNECTIVITY
	default y
	help
	  Módulo core que gestiona el Wireless Management Task (WMT) y el
	  Shared Transport Protocol (STP). Es la base para BT/WiFi/GPS/FM.

if MTK_CONN_COMMON

config MTK_WCN_CORE_EN
	bool "Enable WCN Core Support"
	default y

config MTK_CONNSYS_DEDICATED_LOG_PATH
	bool "Enable Connsys Dedicated Log Path"
	default y

endif
```

## drivers/misc/mediatek/connectivity/connfem/Kconfig
```kconfig
config MTK_CONNFEM
	tristate "MediaTek Connectivity FEM support"
	default y
	help
	  Habilita el soporte para el Front-End Module (FEM) de conectividad.
	  Este módulo es esencial para el MT6879, ya que controla los amplificadores
	  externos (ePA) y los selectores de antena (eLNA) del Motorola Edge 40 Neo.

config MTK_CONNFEM_DT_SUPPORT
	bool "Enable Device Tree support for CONNFEM"
	depends on MTK_CONNFEM
	default y
	help
	  Permite que el driver parsee la configuración de las antenas directamente
	  desde el Device Tree (DTS) de Motorola.
```

## drivers/misc/mediatek/connectivity/conninfra/Kconfig
```kconfig
# drivers/misc/mediatek/connectivity/conninfra/Kconfig

menuconfig MTK_CONN_INFRA
	tristate "MediaTek Connectivity Infrastructure Support (ConnV2)"
	depends on MTK_CONNECTIVITY
	default y
	help
	  Infraestructura de conectividad basada en la arquitectura ConnV2.
	  Necesaria para el MT6879 (Motorola Edge 40 Neo).

if MTK_CONN_INFRA

config MTK_CONN_CONNV2
	bool "Enable ConnV2 Driver Support"
	default y

config MTK_CONN_CONNV2_MT6886
	bool "MT6886/MT6879 Platform Support"
	depends on MTK_CONN_CONNV2
	default y
	help
	  Soporte específico de plataforma. MediaTek suele agrupar el 6879
	  bajo la lógica del 6886 en esta versión de conninfra.

endif
```

## drivers/misc/mediatek/connectivity/fmradio/Kconfig
```kconfig
config MTK_FM
	tristate "MediaTek FM Radio support"
	default y
	help
	  Habilita el soporte para la radio FM en el SoC MT6879.
	  Al ser built-in, la inicialización se realiza durante el arranque
	  del kernel, mejorando la respuesta de la interfaz de audio.

config MTK_FM_CHIP_CONNAC2X
	bool "FM Chip Support: CONNAC2X (MT6879)"
	depends on MTK_FM
	default y
	help
	  Habilita el soporte para el motor de radio FM integrado en la
	  arquitectura CONNAC2X del Dimensity 7030.

config MTK_FM_50KHZ_SUPPORT
	bool "FM 50KHz Step Support"
	depends on MTK_FM
	default y
```

## drivers/misc/mediatek/connectivity/gps/Kconfig
```kconfig
menuconfig MTK_GPS
	tristate "MediaTek GPS Support (MT6879/MET 2.0)"
	default y
	select MTK_CONN_INFRA
	help
	  Habilita el soporte nativo para el subsistema GPS en el Dimensity 7030.
	  Esta configuración integra el soporte para MET 2.0 y xlink para
	  comunicación de baja latencia necesaria en virtualización.

if MTK_GPS

config MTK_GPS_DATA_LINK
	bool "Enable GPS Data Link Layer"
	default y
	help
	  Gestiona los buffers de memoria compartida entre el kernel y el DSP de GPS.

config MTK_GPS_XLINK
	bool "Enable GPS xlink communication"
	default y
	help
	  Protocolo de transporte avanzado para el intercambio de mensajes
	  entre el host y el subsistema GPS.

config MTK_GPS_SUPPORT_MET20
	bool "Enable MET 2.0 HAL support"
	default y
	help
	  Soporte para la arquitectura MediaTek Enhanced Tracking 2.0 presente en el MT6879.

endif
```

## drivers/misc/mediatek/connectivity/power_throttling/Kconfig
```kconfig
config MTK_COMBO_POWER_THROTTLING
	bool "MediaTek Connectivity Power Throttling Support"
	default y
	help
	  Habilita el framework de arbitraje térmico y de batería para 
	  Bluetooth, FM, GPS y Wi-Fi en el MT6879. 
	  Es vital para evitar sobrecalentamiento en el Motorola Edge 40 Neo.

config CONN_PWR_DEBUG
	bool "Power Throttling Debugging"
	depends on MTK_COMBO_POWER_THROTTLING
	default n
	help
	  Activa logs detallados y la interfaz de test (test.c) para verificar
	  cómo el driver baja la potencia de las radios.
```

## drivers/misc/mediatek/connectivity/wlan/Kconfig
```kconfig
# drivers/misc/mediatek/connectivity/wlan/Kconfig

menuconfig MTK_WLAN_DEVICE
	tristate "MediaTek MT6879 (Edge 40 Neo) Connectivity WLAN support"
	depends on NET && INET && WIRELESS
	depends on CFG80211
	select WIRELESS_EXT
	select WEXT_PRIV
	default y
	help
	  Este es el driver de Wi-Fi para el SoC MT6879 (Dimensity 7030).
	  Al seleccionar 'y' (Built-in), el driver se integrará directamente
	  en la imagen del kernel para optimizar la virtualización y el arranque.

if MTK_WLAN_DEVICE

config MTK_WLAN_VIRT_ISOLATION
	bool "Enable Native Virtualization Isolation for WLAN"
	default y
	help
	  Activa el soporte de aislamiento de memoria y protección de DMA
	  específico para entornos virtualizados en Android. Robustece el
	  manejo de buffers en operation_gen4m.c.

config MTK_WLAN_CHIP_ID
	string "Chip ID"
	default "MT6879"

config MTK_COMBO_WIFI_HIF
	string "HIF Interface"
	default "axi"
	help
	  Interfaz de hardware. Para el MT6879 en el Edge 40 Neo, 
	  se utiliza 'axi' para máxima velocidad de transferencia.

config MTK_WLAN_GEN4M_HAVE_SERVICE
	bool "Support WLAN Service and Operation HAL"
	default y
	help
	  Habilita la compilación de wlan_service/glue/hal/gen4m/
	  necesario para las funcionalidades avanzadas de red en Android 13/14+.

endif # MTK_WLAN_DEVICE
```
